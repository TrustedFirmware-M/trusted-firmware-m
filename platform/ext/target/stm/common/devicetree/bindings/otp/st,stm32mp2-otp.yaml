## platform/ext/target/stm/common/devicetree/bindings/otp/st,stm32mp2-otp.yaml
```yaml
# Copyright (c) 2026, STMicroelectronics - All Rights Reserved
# SPDX-License-Identifier: Apache-2.0

description: |
  Embedded one time programmable (OTP) array of fuses. NVMEM abstraction
  for OTP fuses mapped in BSEC driver.

compatible: "st,stm32mp2-otp"

include: [base.yaml, nvmem-consumer.yaml]

properties:
  nvmem-cells:
    required: true

  nvmem-cell-names:
    required: true
```

## platform/ext/target/stm/common/devicetree/bindings/otp/st,stm32mp21-bsec.yaml
```yaml
# Copyright (c) 2026, STMicroelectronics - All Rights Reserved
# SPDX-License-Identifier: Apache-2.0

description: |
  The boot and security control (BSEC) peripheral manages the accesses to an embedded
  one time programmable (OTP) array of fuses. Those fuses are used to store on-chip,
  non-volatile data like boot and security parameters.

compatible: "st,stm32mp21-bsec"

include: st,stm32mp25-bsec.yaml
```

## platform/ext/target/stm/common/devicetree/bindings/otp/st,stm32mp25-bsec.yaml
```yaml
# Copyright (c) 2026, STMicroelectronics - All Rights Reserved
# SPDX-License-Identifier: Apache-2.0

description: |
  The boot and security control (BSEC) peripheral manages the accesses to an embedded
  one time programmable (OTP) array of fuses. Those fuses are used to store on-chip,
  non-volatile data like boot and security parameters.

compatible: "st,stm32mp25-bsec"

include: [base.yaml, memory-region.yaml, access-device.yaml]

properties:
  reg:
    required: true

  memory-region:
    required: false

child-binding:
  include: [nvmem-provider.yaml]

  description: |
    Each child node describes an OTP area.
    The area can look like this :

      hconf1_otp: otp124@1f0 {
        #nvmem-cell-cells = <0>;
        reg = <0x1f0 0x4>;
      };

  properties:
    shadow-provisionning:
      type: array
      description: |
        Value to provision in the shadow of the OTP.
```

## platform/ext/target/stm/common/devicetree/bindings/pinctrl/st,stm32-pinctrl.yaml
```yaml
# Copyright (c) 2026, STMicroelectronics - All Rights Reserved
# SPDX-License-Identifier: Apache-2.0

description: |
  STMicroelectronics's STM32 MCUs intregrate a GPIO and Pin mux/config hardware
  controller. It controls the input/output settings on the available pins and
  also provides ability to multiplex and configure the output of various
  on-chip controllers onto these pads.

compatible: "st,stm32-pinctrl"

include:
  - base.yaml

properties:
  "#gpio-range-cells":
    type: int
    const: 3

gpio-range-cells:
  - gpio_offset
  - pin_offset
  - npins

child-binding:
  description: STM32 pin controller pin group
  child-binding:
    description: STM32 pin controller pin configuration node.
    include:
      - name: pincfg-node.yaml
        property-allowlist:
          - bias-disable
          - bias-pull-down
          - bias-pull-up
          - drive-push-pull
          - drive-open-drain
          - output-low
          - output-high
          - slew-rate

    properties:
      pinmux:
        required: true
        type: array
        description: |
          Integer array, represents gpio pin number and mux setting.
          Supported pin number and mux varies for different SoCs, and are
          defined in dt-bindings/pinctrl/<soc>-pinfunc.h directly.
          These defines are calculated as: ((port * 16 + line) << 8) | function
          With:
          - port: The gpio port index (PA = 0, PB = 1, ..., PK = 11)
          - line: The line offset within the port (PA0 = 0, PA1 = 1, ..., PA15 = 15)
          - function: The function number, can be:
          * 0 : GPIO
          * 1 : Alternate Function 0
          * 2 : Alternate Function 1
          * 3 : Alternate Function 2
          * ...
          * 16 : Alternate Function 15
          * 17 : Analog
          * 18 : Reserved
          To simplify the usage, macro is available to generate "pinmux" field.
          This macro is available here:
            - include/dt-bindings/pinctrl/stm32-pinfunc.h
          Setting the pinmux's function to the Reserved (RSVD) value is used to inform
          the driver that it shall not apply the mux setting. This can be used to
          reserve some pins, for example to a co-processor not running Linux.
          Some examples of using macro:
           /* GPIO A9 set as alernate function 2 */
           ... {
                      pinmux = <STM32_PINMUX('A', 9, AF2)>;
           };
           /* GPIO A9 set as GPIO  */
           ... {
                      pinmux = <STM32_PINMUX('A', 9, GPIO)>;
           };
           /* GPIO A9 set as analog */
           ... {
                      pinmux = <STM32_PINMUX('A', 9, ANALOG)>;
           };
           /* GPIO A9 reserved for co-processor */
           ... {
                      pinmux = <STM32_PINMUX('A', 9, RSVD)>;
           };

      slew-rate:
        enum: [0, 1, 2, 3]
        description: |
          0: Low speed
          1: Medium speed
          2: Fast speed
          3: High speed
```

## platform/ext/target/stm/common/devicetree/bindings/pinctrl/st,stm32mp257-pinctrl-z.yaml
```yaml
# Copyright (c) 2026, STMicroelectronics - All Rights Reserved
# SPDX-License-Identifier: Apache-2.0

description: |
    STM32MP257 Z Pin controller Node
    Based on st,stm32mp257-pinctrl.yaml binding.

compatible: "st,stm32mp257-z-pinctrl"

include: st,stm32-pinctrl.yaml
```

## platform/ext/target/stm/common/devicetree/bindings/pinctrl/st,stm32mp257-pinctrl.yaml
```yaml
# Copyright (c) 2026, STMicroelectronics - All Rights Reserved
# SPDX-License-Identifier: Apache-2.0

description: |
    STM32MP257 Pin controller Node
    Based on st,stm32-pinctrl.yaml binding.

compatible: "st,stm32mp257-pinctrl"

include: st,stm32-pinctrl.yaml
```

## platform/ext/target/stm/common/devicetree/bindings/power/st,stm32mp2-pwr.yaml
```yaml
# Copyright (c) 2026, STMicroelectronics - All Rights Reserved
# SPDX-License-Identifier: Apache-2.0

description: |
  STMicroelectronics power control (PWR) provides an overview of the supply
  architecture of the different power domains of STM32MP2 family.

include:
  - base.yaml
  - reset-device.yaml

properties:
  reg:
    required: true

  resets:
    required: true
    description: |
      backup domain reset

  st,popl-d1-ms:
    type: int
    description: |
      PWR_CPU_ON pulse low configuration (PWR_D1CR)

  st,podh-d2-ms:
    type: int
    description: |
      PWR_ON delay high configuration (PWR_D2CR)

  st,popl-d2-ms:
    type: int
    description: |
      PWR_ON pulse low configuration (PWR_D2CR)

  st,lpcfg-d2:
    type: int
    description: |
      PWR_ON pin configuration (PWR_D2CR)

  st,lplvdly-d2:
      type: int
      description: |
        LPLV delay value (PWR_D2CR), 3bits and with 6xLSI cycles unit
        (0:187 μs... 111:1.5 ms)
```

## platform/ext/target/stm/common/devicetree/bindings/power/st,stm32mp21-pwr.yaml
```yaml
# Copyright (c) 2026, STMicroelectronics - All Rights Reserved
# SPDX-License-Identifier: Apache-2.0

description: |
  STMicroelectronics power control (PWR) provides an overview of the supply
  architecture of the different power domains of STM32MP21 SoC.

compatible: "st,stm32mp21-pwr"

include:
  - st,stm32mp2-pwr.yaml
  - name: st,stm32mp21-syscfg-properties.yaml
    property-allowlist:
      - st,syscfg-vddio

properties:
  st,syscfg-vddio:
    required: true
```

## platform/ext/target/stm/common/devicetree/bindings/power/st,stm32mp25-pwr.yaml
```yaml
# Copyright (c) 2026, STMicroelectronics - All Rights Reserved
# SPDX-License-Identifier: Apache-2.0

description: |
  STMicroelectronics power control (PWR) provides an overview of the supply
  architecture of the different power domains of STM32MP25 SoC.

compatible: "st,stm32mp25-pwr"

include:
  - st,stm32mp2-pwr.yaml
  - name: st,stm32mp25-syscfg-properties.yaml
    property-allowlist:
      - st,syscfg-vddio

properties:
  st,syscfg-vddio:
    required: true
```

## platform/ext/target/stm/common/devicetree/bindings/regulator/st,stm32mp-pwr-regulators.yaml
```yaml
# Copyright (c) 2026, STMicroelectronics - All Rights Reserved
# SPDX-License-Identifier: Apache-2.0

description: |
  STMicroelectronics power control (PWR) provides an overview of the supply
  architecture of the different power supply.

include:
  - base.yaml

child-binding:
  include:
    - power.yaml
    - name: regulator.yaml
      property-allowlist:
        - regulator-name
        - regulator-boot-on
        - regulator-always-on
        - regulator-min-microvolt
        - regulator-max-microvolt
        - regulator-allowed-modes
        - regulator-over-current-protection
        - regulator-ramp-delay
        - regulator-enable-ramp-delay

  properties:
    vin-supply:
      type: phandle
      description: Reference to the regulator supply

    st,iocomp:
      type: array
      description: |
        Defines the pmos and nmos value for an IO domain.
        For STM32MP2x platforms, it corresponds to <pmos nmos>

    st,popl-d1-ms:
      type: int
      description: |
        PWR_CPU_ON pulse low configuration (PWR_D1CR)

    st,podh-d2-ms:
      type: int
      description: |
        PWR_ON delay high configuration (PWR_D2CR)

    st,popl-d2-ms:
      type: int
      description: |
        PWR_ON pulse low configuration (PWR_D2CR)

    st,lpcfg-d2:
      type: int
      description: |
        PWR_ON pin configuration (PWR_D2CR)

    st,lplvdly-d2:
      type: int
      description: |
        LPLV delay value (PWR_D2CR), 3bits and with 6xLSI cycles unit
        (0:187 μs... 111:1.5 ms)
```

## platform/ext/target/stm/common/devicetree/bindings/regulator/st,stm32mp21-pwr-regulators.yaml
```yaml
# Copyright (c) 2026, STMicroelectronics - All Rights Reserved
# SPDX-License-Identifier: Apache-2.0

description: |
  STMicroelectronics power control (PWR) provides an overview of the supply
  architecture of the different power supply. The regulators need to be defined
  as child nodes, strictly following the vddio1, vddio2, vddio3, vddio,
  vdda18adc. For example:

    pwr: pwr@54210000 {
      compatible = "st,stm32mp21-pwr";
      ...
      regulators {
        compatible = "st,stm32mp21-pwr-regulators";

        vdda18adc {
          /* all properties for vdda18adc */
        };
        vddio1 {
          /* all properties for vddio1 */
        };
        vddio2 {
          /* all properties for vddio2 */
        };
        vddio3 {
          /* all properties for vddio3 */
        };
        vddio {
          /* all properties for vddio */
        };
      };
    };

compatible: "st,stm32mp21-pwr-regulators"

include:
  - st,stm32mp-pwr-regulators.yaml
```

## platform/ext/target/stm/common/devicetree/bindings/regulator/st,stm32mp25-pwr-regulators.yaml
```yaml
# Copyright (c) 2026, STMicroelectronics - All Rights Reserved
# SPDX-License-Identifier: Apache-2.0

description: |
  STMicroelectronics power control (PWR) provides an overview of the supply
  architecture of the different power supply. The regulators need to be defined
  as child nodes, strictly following the vddio1, vddio2, vddio3, vddio4, vddio,
  vdd33ucpd, vdda18adc, vddgpu, node names. For example:

    pwr: pwr@54210000 {
      compatible = "st,stm32mp25-pwr";
      ...
      regulators {
        compatible = "st,stm32mp25-pwr-regulators";

        vdd33ucpd {
          /* all properties for vdd33ucpd */
        };
        vdda18adc {
          /* all properties for vdda18adc */
        };
        vddgpu {
          /* all properties for vddgpu */
        };
        vddio1 {
          /* all properties for vddio1 */
        };
        vddio2 {
          /* all properties for vddio2 */
        };
        vddio3 {
          /* all properties for vddio3 */
        };
        vddio4 {
          /* all properties for vddio4 */
        };
        vddio {
          /* all properties for vddio */
        };
      };
    };

compatible: "st,stm32mp25-pwr-regulators"

include:
  - st,stm32mp-pwr-regulators.yaml
```

## platform/ext/target/stm/common/devicetree/bindings/regulator/st,stpmic.yaml
```yaml
# Copyright (c) 2026, STMicroelectronics - All Rights Reserved
# SPDX-License-Identifier: Apache-2.0

description: |
  STMicroelectronics Power Management Integrated Circuit (PMIC)

include:
  - base.yaml
  - interrupt-controller.yaml

properties:
  "#interrupt-cells":
    const: 1

interrupt-cells:
  - irq
```

## platform/ext/target/stm/common/devicetree/bindings/regulator/st,stpmic1l.yaml
```yaml
# Copyright (c) 2026, STMicroelectronics - All Rights Reserved
# SPDX-License-Identifier: Apache-2.0

description: |
  STMicroelectronics Power Management Integrated Circuit (PMIC) STPMIC1L

  The STPMIC1L has two buck converters, four LDOs and five GPOs.
  All need to be defined as children of regulators node, with node names:
  buck2..5, ldo1..7 and gpo1..2 nodes
  see st,stpmic2-regulators.yaml for reguators bindings

  stpmic1l: pmic@33 {
    compatible = "st,stpmic1l";
    reg = <0x33>;
    ...
    regulators {
      compatible = "st,stpmic2-regulators";

      buck1 {
      };
      ...
      buck2 {
      };
      ldo2 {
      };
      ...
      ldo5 {
      };
      gpo1 {
      };
      ...
      gpo2 {
      };
    };
  };

compatible: "st,stpmic1l"

include:
  - st,stpmic.yaml
```
