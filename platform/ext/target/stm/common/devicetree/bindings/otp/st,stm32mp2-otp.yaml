## platform/ext/target/stm/common/devicetree/bindings/regulator/st,stpmic2-regulators.yaml
```yaml
# Copyright (c) 2026, STMicroelectronics - All Rights Reserved
# SPDX-License-Identifier: Apache-2.0

description: |
  STMicroelectronics regulators provided by STPMIC Power Management Integrated Circuit

  The STPMIC2 has several regulators as buck converters and LDOs and all need
  to be defined as children nodes with the expected name.

  The STPMIC25 has seven buck converters and nine LDOs:
  BUCK1..7, LDO1..8 and REFDDR.
  The STPMIC1L provides BUCK1, BUCK2, LDO2..5, GPO1..2 regulators
  The STPMIC2L provides BUCK1..4, LDO1..LDO7, GPO1..5 regulators

  Each child regulator node can have sub-nodes as defined in the generic binding
  which define the regulator configuration in low power modes:
  the alternate setting (when the regulator is controlled by a pwrctrl line
  st,pwrctrl-enable = true) or the forced setting (st,pwrctrl-enable = false).
  The supported sub-node are:
  - default: applied for Stop1, LP-Stop1, Stop2, LP-Stop2
  - lplv: applied for LPLV-STOP1, LPLV-STOP2
  - standby: applied for Standby with DDR in self-refresh
             (Standby1 for STM32MP25/23)
  - off: applied for Standby with DDR OFF
        (Standby2 for STM32MP25/23)

  For example:

  stpmic25: pmic@33 {
    compatible = "st,stpmic2";
    reg = <0x33>;
    ...
    regulators {
      compatible = "st,stpmic2-regulators";

      buck1 {
        /* all properties for buck1 */
        default {
        };
        lplv {
        };
        standby {
        };
        off {
        };
      };
      ...
      buck7 {
        /* all properties for buck7 */
      };
      ldo1 {
        /* all properties for ldo1 */
      };
      ...
      ldo8 {
        /* all properties for ldo8 */
      };
      refddr {
        /* all properties for refddr ldo */
      };
    };
  };

compatible: "st,stpmic2-regulators"

include: base.yaml

child-binding:
  include:
    - name: regulator.yaml
      property-allowlist:
        - regulator-name
        - regulator-boot-on
        - regulator-always-on
        - regulator-min-microvolt
        - regulator-max-microvolt
        - regulator-allowed-modes
        - regulator-over-current-protection
        - regulator-enable-ramp-delay
        - regulator-pull-down

  properties:
    st,mask-reset:
      type: boolean
      description: |
        mask reset for this regulator, the regulator configuration
        is maintained during pmic reset.

    st,pwrctrl-enable:
      type: boolean
      description: |
        enable pwrctrl mode if it's available on this regulator.

    st,pwrctrl-reset:
      type: boolean
      description: |
        enable pwrctrl reset mode if it's available on this regulator.

    st,pwrctrl-sel:
      type: int
      description: |
        configure pwrctrl source selection
      enum: [0, 1, 2, 3]

    st,regulator-bypass-microvolt:
      type: int
      description: |
        regulator output voltage when configured in bypass.
        Authorize automatic bypass mode selection depending on voltage.

    st,regulator-sink-source:
      type: boolean
      description: |
        enable sink-source mode if it's available on this regulator.

    st,alternate-input-source:
      type: boolean
      description: |
        enable secondary input source on LDO1.

  child-binding:
    include:
      - name: regulator.yaml
        property-allowlist:
          - regulator-on-in-suspend
          - regulator-off-in-suspend
          - regulator-suspend-microvolt
```

## platform/ext/target/stm/common/devicetree/bindings/regulator/st,stpmic2.yaml
```yaml
# Copyright (c) 2026, STMicroelectronics - All Rights Reserved
# SPDX-License-Identifier: Apache-2.0

description: |
  STMicroelectronics Power Management Integrated Circuit (PMIC) STPMIC25

  The STPMIC25 has seven buck converters and nine LDOs (inlcuing one refddr).
  All need to be defined as children of regulators node, with node names:
  buck1..7, ldo1..8 and refddr
  see st,stpmic2-regulators.yaml for reguators bindings

  stpmic25: pmic@33 {
    compatible = "st,stpmic2";
    reg = <0x33>;
    ...
    regulators {
      compatible = "st,stpmic2-regulators";

      buck1 {
      };
      ...
      buck7 {
      };
      ldo1 {
      };
      ...
      ldo8 {
      };
      refddr {
      };
    };
  };

compatible: "st,stpmic2"

include:
  - st,stpmic.yaml
```

## platform/ext/target/stm/common/devicetree/bindings/regulator/st,stpmic2l.yaml
```yaml
# Copyright (c) 2026, STMicroelectronics - All Rights Reserved
# SPDX-License-Identifier: Apache-2.0

description: |
  STMicroelectronics Power Management Integrated Circuit (PMIC) STPMIC2L

  The STPMIC2L has four buck converters, seven LDOs and two GPOs.
  All need to be defined as children of regulators node, with node names:
  buck1..4, ldo1..7 and gpo1..5
  see st,stpmic2-regulators.yaml for reguators bindings

  stpmic2l: pmic@33 {
    compatible = "st,stpmic2l";
    reg = <0x33>;
    ...
    regulators {
      compatible = "st,stpmic2-regulators";

      buck1 {
      };
      ...
      buck4 {
      };
      ldo1 {
      };
      ...
      ldo7 {
      };
      gpo1 {
      };
      ...
      gpo5 {
      };
    };
  };

compatible: "st,stpmic2l"

include:
  - st,stpmic.yaml
```

## platform/ext/target/stm/common/devicetree/bindings/reserved-memory/reserved-memory.yaml
```yaml
# Copyright (c) 2026, STMicroelectronics - All Rights Reserved
# SPDX-License-Identifier: Apache-2.0

description: |
  Reserved memory is specified as a node under the /reserved-memory node. The
  operating system shall exclude reserved memory from normal usage one can
  create child nodes describing particular reserved (excluded from normal use)
  memory regions. Such memory regions are usually designed for the special
  usage by various device drivers.

  Each child of the reserved-memory node specifies one or more regions
  of reserved memory. Each child node may either use a 'reg' property to
  specify a specific range of reserved memory, or a 'size' property with
  optional constraints to request a dynamically allocated block of
  memory.

compatible: "reserved-memory"

include: [base.yaml]

properties:
  reg:
    required: true

  "#memory-region-cells":
    required: true
    type: int
    const: 0

  arm,sau-nsc:
    type: boolean
    description: |
      Add this property if the SAU region is Non-secure callable.
      Controls whether Non-secure state is permitted to execute a Secure Gateway
      instruction from this region.

  tfm,memory-attr:
    type: int
    description: |
      Attribute or set of attributes (bitmask) for the memory region. See
      'include/dt-bindings/memory-attr/memory-attr.h' for a
      comprehensive list with description of possible values.

  st,protreg:
    type: array
    description: |
      protection value of rif peripherals, each entry is defined by a 32 bit.

  memory-region:
    type: phandle-array
    specifier-space: memory-region
    description: List of memory region phandles
```

## platform/ext/target/stm/common/devicetree/bindings/reset/st,stm32-rcc-reset.yaml
```yaml
# Copyright (c) 2026, STMicroelectronics - All Rights Reserved
# SPDX-License-Identifier: Apache-2.0

description: |
  STM32 Reset and Clock Control (RCC) node.
  This node is in charge of reset control.

  To specify the reset line in a peripheral, the standard resets property needs
  to be used, e.g.:

    usart5: serial@xxx {
        ...
        /* Cell contains information about RCU register offset and bit */
        resets = <&rctl UART5_R>;
        ...
    };

  RCC reset cells are available in
  include/dt-bindings/reset/stm32{soc_family}_resets.h header files.

compatible: "st,stm32-rcc-reset"

include: [reset-controller.yaml, base.yaml]

properties:
  "#reset-cells":
    const: 1

reset-cells:
  - id
```

## platform/ext/target/stm/common/devicetree/bindings/reset/st,stm32mp25-hpdma-reset.yaml
```yaml
# Copyright (c) 2026, STMicroelectronics - All Rights Reserved
# SPDX-License-Identifier: Apache-2.0

description: |
  STM32 HPDMA Reset node.
  This node is in charge of hpdma ip reset.

compatible: "st,stm32mp25-hpdma-reset"

include: [reset-controller.yaml, base.yaml]

properties:
  "#reset-cells":
    const: 1
    description: Since full ip is reset, only cell value to 0 is supported

reset-cells:
  - id
```

## platform/ext/target/stm/common/devicetree/bindings/reset/st,stm32mp25-rcc-reset.yaml
```yaml
# Copyright (c) 2026, STMicroelectronics - All Rights Reserved
# SPDX-License-Identifier: Apache-2.0

description: |
  STM32MP25 Reset controller node

compatible: "st,stm32mp25-rcc-reset"

include: st,stm32-rcc-reset.yaml
```

## platform/ext/target/stm/common/devicetree/bindings/rif/st,stm32mp21-risaf-enc.yaml
```yaml
# Copyright (c) 2026, STMicroelectronics - All Rights Reserved
# SPDX-License-Identifier: Apache-2.0

description: |
        RISAF (enc:encode) managing DDR includes the DDR memory cipher engine (DDRMCE) feature.
        Specific encryption for stm32mp21.

compatible: "st,stm32mp21-risaf-enc"

include:
   - st,stm32mp25-risaf-enc.yaml

properties:
   st,mce-keysize-bits:
      type: int
      description: key size encryption in bits.
      enum: [128, 256]
```

## platform/ext/target/stm/common/devicetree/bindings/rif/st,stm32mp25-iac.yaml
```yaml
# Copyright (c) 2026, STMicroelectronics - All Rights Reserved
# SPDX-License-Identifier: Apache-2.0

description: |
  The RIF (resource isolation framework) is a comprehensive set of hardware blocks
  designed to enforce and manage isolation of STM32 hardware resources such as memory
  and peripherals.

  The RIF uses the IAC (illegal access controller) to centralize the detection of RIF-related
  illegal accesses, managed by a secure application running in the trusted domain.

compatible: "st,stm32mp25-iac"

include: base.yaml

properties:
  reg:
    required: true

  interrupts:
    required: true

  id_disable:
    type: array
    description: rif index which can be disabled (no irq occurs)
```

## platform/ext/target/stm/common/devicetree/bindings/rif/st,stm32mp25-pwr-rif.yaml
```yaml
# Copyright (c) 2026, STMicroelectronics - All Rights Reserved
# SPDX-License-Identifier: Apache-2.0

description: |
  the PWR implements the following security/isolation requirements which apply
  to any defined security domain:
    - filtering of secure/non-secure accesses
    - privileged/unprivileged accesses
    - filtering of hardware execution compartments

compatible: "st,stm32mp25-pwr-rif"

include:
  - base.yaml
  - access-controller.yaml
  - st,stm32mp25-rif.yaml

properties:
  "#access-controller-cells":
    const: 1

access-controller-cells:
  - protreg
```

## platform/ext/target/stm/common/devicetree/bindings/rif/st,stm32mp25-rcc-rif.yaml
```yaml
# Copyright (c) 2026, STMicroelectronics - All Rights Reserved
# SPDX-License-Identifier: Apache-2.0

description: |
  the RCC implements the following security/isolation requirements which apply
  to any defined security domain:
    - filtering of secure/non-secure accesses
    - filtering of privileged/unprivileged accesses
    - locking of the configuration for each ressources
    - filtering of hardware execution compartments (CIDs)

compatible: "st,stm32mp25-rcc-rif"

include:
  - base.yaml
  - access-controller.yaml
  - st,stm32mp25-rif.yaml

properties:
  "#access-controller-cells":
    const: 1

access-controller-cells:
  - protreg
```
