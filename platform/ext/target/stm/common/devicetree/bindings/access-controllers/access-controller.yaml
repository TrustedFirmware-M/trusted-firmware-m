## platform/ext/target/stm/common/devicetree/bindings/access-controllers/access-controller.yaml
```yaml
# Copyright (c) 2026, STMicroelectronics - All Rights Reserved
# SPDX-License-Identifier: Apache-2.0

description: |
  Common access controllers properties

  Access controllers are in charge of stating which of the hardware blocks under
  their responsibility (their domain) can be accesssed by which compartment. A
  compartment can be a cluster of CPUs (or coprocessors), a range of addresses
  or a group of hardware blocks. An access controller's domain is the set of
  resources covered by the access controller.

  This device tree binding can be used to bind devices to their access
  controller provided by access-controllers property. In this case, the device
  is a consumer and the access controller is the provider.

  An access controller can be represented by any node in the device tree and
  can provide one or more configuration parameters, needed to control parameters
  of the consumer device. A consumer node can refer to the provider by phandle
  and a set of phandle arguments, specified by '#access-controller-cells'
  property in the access controller node.

  Access controllers are typically used to set/read the permissions of a
  hardware block and grant access to it. Any of which depends on the access
  controller. The capabilities of each access controller are defined by the
  binding of the access controller device.

  Each node can be a consumer for the several access controllers.

properties:
  "#access-controller-cells":
    type: int
    required: true
    description: |
      Number of cells in an access-controllers specifier;
      Can be any value as specified by device tree binding documentation
      of a particular provider. The node is an access controller.
```

## platform/ext/target/stm/common/devicetree/bindings/access-controllers/access-device.yaml
```yaml
# Copyright (c) 2026, STMicroelectronics - All Rights Reserved
# SPDX-License-Identifier: Apache-2.0

description: This file needs to be included by devices that need a access controller.

properties:
  access-controllers:
    type: phandle-array
    description: acces controller information

  access-controller-names:
    type: string-array
    description: Name of each reset
```

## platform/ext/target/stm/common/devicetree/bindings/cache/st,stm32mp2-dcache.yaml
```yaml
# Copyright (c) 2026, STMicroelectronics - All Rights Reserved
# SPDX-License-Identifier: Apache-2.0

description: |
  The data cache (DCACHE) is introduced on S-AHB system bus of the Cortex ® -M33
  processor to improve the performance of data traffic to/from external memories.
  Some specific features like hit-under-miss and critical-word-first refill policy allow optimum
  performance on external memories data accesses.

compatible: "st,stm32mp2-dcache"

include:
  - base.yaml

properties:
  reg:
    required: true

  interrupts:
    required: true
```

## platform/ext/target/stm/common/devicetree/bindings/clock/st,stm32mp21-rcc.yaml
```yaml
# Copyright (c) 2026, STMicroelectronics - All Rights Reserved
# SPDX-License-Identifier: Apache-2.0

description: |
  STM32MP21 RCC node.

compatible: "st,stm32mp21-rcc"

include: st,stm32mp25-rcc.yaml
```

## platform/ext/target/stm/common/devicetree/bindings/clock/st,stm32mp25-rcc.yaml
```yaml
# Copyright (c) 2026, STMicroelectronics - All Rights Reserved
# SPDX-License-Identifier: Apache-2.0

description: |
  The RCC IP is both a reset and a clock controller.
  RCC makes also power management (resume/supend and wakeup interrupt).
  Please also refer to reset for common reset controller binding usage.

  Specifying clocks
  =================

  All available clocks are defined as preprocessor macros in
  dt-bindings/clock/st,stm32mp25-rcc.h and can be used in device
  tree sources.

  Specifying softreset control of devices
  =======================================

  Device nodes should specify the clock channel required in their "clocks"
  property, containing a phandle to the clock device node and an index specifying
  which channel to use.
  The index is the bit number within the RCC registers bank, starting from RCC
  base address.
  It is calculated as: index = register_offset / 4 * 32 + bit_offset.
  Where bit_offset is the bit offset within the register.

compatible: "st,stm32mp25-rcc"

include:
  - base.yaml
  - clock-controller.yaml
  - st,stm32mp25-rif.yaml

properties:
  reg:
    required: true

  "#clock-cells":
    const: 1

  st,c1msrd:
    type: int
    description: |
      defines the minimum duration of the low-level pulse on NRSTC1MS when C1MSRST is high.

  st,busclk:
    type: array
    description: |
      - The property is a list of dividers defined by macros DIV(DIV_<DIV-CLOCK>,
        value) as defined by header file dt-bindings/clock/stm32mp25-clksrc.h.
      - For the STM32MP25 family there are 8 dividers values expected:
        LSMCU APB1 APB2 APB3 APB4 DIV_APBDBG
      - Each divider value uses the DIV coding defined in RCC associated register
        RCC_xxxDIVR. In most cases, it is:
          0x0: not divided
          0x1: division by 2
          0x2: division by 4
          0x3: division by 8
          ...
      - Property can be used to configure the clock main dividers value:
          st,busclk = <
            DIV(DIV_LSMCU, 1)
            DIV(DIV_APB1, 0)
            DIV(DIV_APB2, 0)
            DIV(DIV_APB3, 0)
            DIV(DIV_APB4, 0)
            DIV(DIV_APBDBG, 0)
          >;

  st,flexgen:
    type: array
    description: |
      - Used to configure the flexgen clock selection.
        The property is a list of flex clock source identifiers defined
        by macros as defined by header file dt-bindings/clock/stm32mp25-clksrc.h:
          - FLEXGEN_CFG(chanel, XBAR_SRC_<PARENT-CLOCK>, pre_div, final_div)
            - pre_div
                0x0: not divided
                0x1: division by 2
                0x3: division by 4
                0x3ff: division by 1024
            - final_div
                0x0: not divided
                0x1: division by 2
                0x2: division by 3
                ...
                0x3f: division by 64
      - Property can be used to configure the clock distribution tree:
        st,flexgen = <
                FLEXGEN_CFG(0, XBAR_SRC_PLL4, 0, 2)
                FLEXGEN_CFG(2, XBAR_SRC_PLL4, 0, 1)
                FLEXGEN_CFG(3, XBAR_SRC_PLL4, 0, 2)
                FLEXGEN_CFG(4, XBAR_SRC_PLL4, 0, 3)
                FLEXGEN_CFG(5, XBAR_SRC_PLL4, 0, 2)
                FLEXGEN_CFG(6, XBAR_SRC_PLL4, 0, 1)
                FLEXGEN_CFG(7, XBAR_SRC_PLL4, 0, 11)
                ...
                FLEXGEN_CFG(59, XBAR_SRC_PLL4, 0, 1)
                FLEXGEN_CFG(60, XBAR_SRC_PLL6, 0, 3)
                FLEXGEN_CFG(61, XBAR_SRC_PLL4, 0, 7)
                FLEXGEN_CFG(62, XBAR_SRC_PLL4, 0, 7)
                FLEXGEN_CFG(63, XBAR_SRC_PLL4, 0, 2)
        >;

  st,kerclk:
    type: array
    description: |
      - used to configure the peripherals kernel clock selection.
        The property is a list of peripheral kernel clock source identifiers defined
        by macros as defined by header file dt-bindings/clock/stm32mp25-clksrc.h:
          - DIV(DIV_<DIV-CLOCK>, value)
          - MUX_CFG(MUX_<KERNEL-CLOCK>, MUX<KERNEL-CLOCK>_<PARENT-CLOCK>
          - MCO_CFG(MCO_CLOCK, MUX_<MCO-CLOCK>_<PARENT-CLOCK>, ON / OFF)
      - st,kerclk may not list all the kernel clocks and has no ordering requirements.
      - Property can be used to configure the clock distribution tree:
        st,kerclk = <
                DIV_CFG(DIV_RTC, 23)
                MUX_CFG(MUX_ADC12, MUX_ADC12_FLEX46)
                MUX_CFG(MUX_ADC3, MUX_ADC3_FLEX47)
                MUX_CFG(MUX_USB2PHY1, MUX_USB2PHY1_FLEX57)
                MUX_CFG(MUX_USB2PHY2, MUX_USB2PHY2_FLEX58)
                MUX_CFG(MUX_USB3PCIEPHY, MUX_USB3PCIEPHY_FLEX34)
                MUX_CFG(MUX_DSIPHY, MUX_DSIPHY_FLEX28)
                MUX_CFG(MUX_DSIBLANE, MUX_DSIBLANE_DSIPHY)
                MUX_CFG(MUX_LVDSPHY, MUX_LVDSPHY_FLEX32)
                MUX_CFG(MUX_DTS, MUX_DTS_HSE)
                MUX_CFG(MUX_RTC, MUX_RTC_HSE)
                MUX_CFG(MUX_D3PER, MUX_D3PER_LSE)
                MCO_CFG(MCO2, MUX_MCO2_FLEX62, MCO_OFF)
        >;

  st,pll-enable:
    type: phandles
    description: |
      Phandle of the default pll configuration.
      A pll could have several configuration (5 max) and should be described in a subnode
      just below.

clock-cells:
  - bits

child-binding:
  child-binding:
    properties:
      cfg:
        description: |
         The parameters for PLL frequency configuration in the following order
         <FBDIV FREFDIV POSTDIV1 POSTDIV2>
         FREF * (FBDIV / FREFDIV) / POSTDIV1 / POSTDIV2
         POSTDIVx
           0x0: not applicable
           0x1: division by 1
           ...
           0x7: division by 7
          (see ref manual for details)
        type: array

      src:
        description: |
          Clock source configuration values are defined by macros MUX_CFG(MUX_<NAME>_<SOURCE>)
          from dt-bindings/clock/stm32mp25-clksrc.h.
        type: int
      frac:
        description: |
          Fractional part of the multiplication factor
          (optional, PLL is in integer mode when absent).
        type: int
      csg:
        description: |
          Clock Spreading Generator (optional) with parameters in the
          following order: MOD_PER INC_STEP SSCG_MODE.
          MOD_PER: Modulation Period Adjustment
          INC_STEP: Modulation Depth Adjustment
          SSCG_MODE: Spread spectrum clock generator mode, with associated
          defines from stm32mp13-clksrc.h:
          - SSCG_MODE_CENTER_SPREAD = 0
          - SSCG_MODE_DOWN_SPREAD = 1
        type: int
```

## platform/ext/target/stm/common/devicetree/bindings/cpu/arm,armv8m-mpu.yaml
```yaml
# Copyright (c) 2026, STMicroelectronics - All Rights Reserved
# SPDX-License-Identifier: Apache-2.0

description: ARMv8-M MPU (Memory Protection Unit)

compatible: "arm,armv8m-mpu"

include:
  - base.yaml
  - memory-region.yaml

properties:
  reg:
    required: true

  memory-region:
    description: |
      List MPU regions to define the Memory Protection.
```

## platform/ext/target/stm/common/devicetree/bindings/cpu/arm,armv8m-sau.yaml
```yaml
# Copyright (c) 2026, STMicroelectronics - All Rights Reserved
# SPDX-License-Identifier: Apache-2.0

description: ARMv8-M Security Attribution Unit

compatible: "arm,armv8m-sau"

include:
  - base.yaml
  - memory-region.yaml

properties:
  reg:
    required: true

  memory-region:
    description: |
      List SAU regions to define the security attribute.
```

## platform/ext/target/stm/common/devicetree/bindings/crypto/st,stm32mp13-saes.yaml
```yaml
# Copyright (c) 2026, STMicroelectronics - All Rights Reserved
# SPDX-License-Identifier: Apache-2.0

description: |
  The secure AES coprocessor (SAES) encrypts or decrypts data, using an
  algorithm and implementation fully compliant with the advanced encryption
  standard (AES) defined in Federal information processing standards (FIPS)
  publication 197. It incorporates a protection against side-channel attacks
  (SCA), including differential power analysis (DPA), certified SESIP and
  PSA security assurance level 3. The peripheral supports CTR, GCM, GMAC,
  CCM, ECB, and CBC chaining modes for key sizes of 128 or 256 bits, as
  well as special modes such as hardware secret key encryption/decryption
  (Wrapped-key mode) and key sharing.
  SAES has the possibility to load by hardware STM32 hardware secret keys
  (boot hardware key BHK and derived hardware unique key DHUK), usable but
  not readable by application.

compatible: "st,stm32mp13-saes"

include:
  - name: access-device.yaml
  - name: base.yaml
  - name: reset-device.yaml

properties:
  reg:
    required: true

  resets:
    required: true

  clocks:
    required: true
```

## platform/ext/target/stm/common/devicetree/bindings/crypto/st,stm32mp21-saes.yaml
```yaml
# Copyright (c) 2026, STMicroelectronics - All Rights Reserved
# SPDX-License-Identifier: Apache-2.0

description: |
  The secure AES coprocessor (SAES) embedded in STM32MP21 SoC inherits of the
  features described in st,stm32mp13-saes.yaml. In this version, support for
  192-bit key sizes has been introduced, in addition to the existing 128-bit and
  256-bit key sizes.

compatible: "st,stm32mp21-saes"

include:
  - st,stm32mp13-saes.yaml
```

## platform/ext/target/stm/common/devicetree/bindings/ddr/st,stm32mp2-ddr.yaml
```yaml
# Copyright (c) 2023 STMICROELECTRONICS
# SPDX-License-Identifier: Apache-2.0

description: |
  STM32 ddr controller provides a complete memory interface solution for the DDR memory
  subsystem (DDRCTRL and DDRPHY).
  Jedec compliant lpddr4, ddr4, ddr3l

compatible: "st,stm32mp2-ddr"

include: [base.yaml]

properties:
  reg:
    required: true

  reg-names:
    required: true
    description: Name of each register space "ctrl", "phy", "dbg"

  clocks:
    required: true

  st,mem-name:
    type: string
    required: true
    description: name for the DDR configuration, a simple string for information

  st,mem-speed:
    type: int
    required: true
    description: DDR expected speed in kHz

  st,mem-size:
    type: array
    required: true
    description: DDR mem size in bytes, split in 2 32bit values to have size on 64bit

  st,ctl-reg:
    type: array
    required: true
    description: controller values depending on the DDR type

  st,ctl-timing:
    type: array
    required: true
    description: controller values depending on the DDR frequency and timing parameters

  st,ctl-map:
    type: array
    required: true
    description: controller values depending on the address mapping

  st,ctl-perf:
    type: array
    required: true
    description: controller values depending on performance and scheduling

  st,phy-basic:
    type: array
    required: true
    description: basic entry values for the PHYINIT driver

  st,phy-advanced:
    type: array
    required: true
    description: advanced entry values for the PHYINIT driver

  st,phy-mr:
    type: array
    required: true
    description: mode register entry values for the PHYINIT driver

  st,phy-swizzle:
    type: array
    required: true
    description: swizzling (i.e. signal/ball multiplexing) entry values for the PHYINIT driver

  vpp-supply:
    type: phandle
    description: Reference to the regulator that controls vpp power

  vdd-supply:
    type: phandle
    description: Reference to the regulator that controls vdd power

  vref-supply:
    type: phandle
    description: Reference to the regulator that controls vref power

  vtt-supply:
    type: phandle
    description: Reference to the regulator that controls vtt power

  vdd1-supply:
    type: phandle
    description: Reference to the regulator that controls vdd1 power

  vdd2-supply:
    type: phandle
    description: Reference to the regulator that controls vdd2 power

  vddq-supply:
    type: phandle
    description: Reference to the regulator that controls vddq power
```

## platform/ext/target/stm/common/devicetree/bindings/dma/st,stm32mp21-dma3.yaml
```yaml
# Copyright (c) 2026, STMicroelectronics - All Rights Reserved
# SPDX-License-Identifier: Apache-2.0

description: |
  The STM32 DMA3 is a direct memory access controller with different features
  depending on its hardware configuration.
  It is either called LPDMA (Low Power), GPDMA (General Purpose) or
  HPDMA (High Performance).

compatible: "st,stm32mp21-dma3"

include:
  - st,stm32mp25-dma3.yaml
  - name: st,stm32mp21-syscfg-properties.yaml
    property-allowlist:
      - st,syscfg-arcr
```
