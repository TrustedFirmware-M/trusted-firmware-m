## platform/ext/target/stm/common/devicetree/bindings/dma/st,stm32mp25-dma3.yaml
```yaml
# Copyright (c) 2026, STMicroelectronics - All Rights Reserved
# SPDX-License-Identifier: Apache-2.0

description: |
  The STM32 DMA3 is a direct memory access controller with different features
  depending on its hardware configuration.
  It is either called LPDMA (Low Power), GPDMA (General Purpose) or
  HPDMA (High Performance).

compatible: "st,stm32mp25-dma3"

include:
  - base.yaml
  - reset-device.yaml
  - st,stm32mp25-rif.yaml

properties:
  reg:
    required: true

  clocks:
    required: true

  resets:
    required: true

  st,errata-ahbrisab:
    type: boolean
    description: |
      If set, a software workaround is set to that the RISAB AHB errata is
      managed. Whenever CID filtering is enabled on either RISAB3/4/5 instances,
      then DMA channels cannot hold the CID0 value on the bus to avoid unwanted
      access rights to some memories.
```

## platform/ext/target/stm/common/devicetree/bindings/entropy/entropy-device.yaml
```yaml
# Copyright (c) 2026, STMicroelectronics - All Rights Reserved
# SPDX-License-Identifier: Apache-2.0

description: |
   This file needs to be included by devices that need to fill a buffer with entropy.

properties:
   entropy:
      type: phandle
      description: phandle to entropy controller node
```

## platform/ext/target/stm/common/devicetree/bindings/entropy/st,stm32-rng.yaml
```yaml
# Copyright (c) 2026, STMicroelectronics - All Rights Reserved
# SPDX-License-Identifier: Apache-2.0

description: |
  The STM32 hardware random number generator is a simple fixed purpose
  IP and is fully separated from other crypto functions.

include:
  - access-device.yaml
  - name: base.yaml
  - name: reset-device.yaml

properties:
  reg:
    required: true

  resets:
    required: true

  clocks:
    required: true

  clock-names:
    required: true
    enum:
      - "rng_clk"
      - "rng_hclk"
    description: |
      Expected names are the following:
      - "rng_clk" is the RNG clock domain source, used to compute CLKDIV
      - "rng_hclk" is the AHB bus clock feeding the peripheral
      rng_clk may be backed by a clock controller or by a fixed-clock device without clk_subsys
```

## platform/ext/target/stm/common/devicetree/bindings/entropy/st,stm32mp25-rng.yaml
```yaml
# Copyright (c) 2026, STMicroelectronics - All Rights Reserved
# SPDX-License-Identifier: Apache-2.0

description: |
  The STM32 hardware random number generator is a simple fixed purpose
  IP and is fully separated from other crypto functions.

compatible: "st,stm32mp25-rng"

include: st,stm32-rng.yaml
```

## platform/ext/target/stm/common/devicetree/bindings/gpio/st,stm32-gpio.yaml
```yaml
# Copyright (c) 2026, STMicroelectronics - All Rights Reserved
# SPDX-License-Identifier: Apache-2.0

description: |
  STMicroelectronics's STM32 MCUs intregrate a GPIO and Pin mux/config hardware
  controller. This part is focused on gpio bank configuration.

compatible: "st,stm32-gpio"

include:
  - base.yaml
  - gpio-controller.yaml
  - st,stm32mp25-rif.yaml

properties:
  reg:
    required: true

  clocks:
    required: true

  "#gpio-cells":
    const: 2

  st,bank-name:
    type: string
    description:
      Should be a name string for this bank as specified in the datasheet.
    enum:
      - GPIOA
      - GPIOB
      - GPIOC
      - GPIOD
      - GPIOE
      - GPIOF
      - GPIOG
      - GPIOH
      - GPIOI
      - GPIOJ
      - GPIOK
      - GPIOZ

  st,bank-ioport:
    type: int
    description: |
      Should correspond to the EXTI IOport selection (EXTI line used
      to select GPIOs as interrupts).

gpio-cells:
  - pin
  - flags
```

## platform/ext/target/stm/common/devicetree/bindings/i2c/st,stm32-i2c.yaml
```yaml
# Copyright (c) 2026, STMicroelectronics - All Rights Reserved
# SPDX-License-Identifier: Apache-2.0

description: |
  I2C controller embedded in STMicroelectronics STM32 I2C platform

compatible: "st,stm32mp25-i2c"

include: [i2c-controller.yaml, pinctrl-device.yaml, reset-device.yaml]

properties:
  reg:
    required: true

  pinctrl-0:
    required: true

  pinctrl-names:
    required: true

  resets:
    required: true

  clocks:
    required: true
```

## platform/ext/target/stm/common/devicetree/bindings/interrupt-controller/arm,v8m-nvic.yaml
```yaml
description: ARMv8-M NVIC (Nested Vectored Interrupt Controller)

compatible: "arm,v8m-nvic"

include: [interrupt-controller.yaml, base.yaml]

properties:
  reg:
    required: true

  arm,num-irq-priority-bits:
    type: int
    required: true
    description: number of bits of IRQ priorities

  arm,num-irqs:
    type: int
    required: true
    description: Number of irqs supported by the interrupt controller

  "#interrupt-cells":
    const: 2

interrupt-cells:
  - irq
  - priority
```

## platform/ext/target/stm/common/devicetree/bindings/interrupt-controller/st,stm32mp1-exti.yaml
```yaml
# Copyright (c) 2026, STMicroelectronics - All Rights Reserved
# SPDX-License-Identifier: Apache-2.0

description: |
  The extended interrupts and event controller (EXTI) manages the individual CPU and
  system wake-up through configurable and direct event inputs.

compatible: "st,stm32mp1-exti"

include:
  - base.yaml
  - interrupt-controller.yaml
  - st,stm32mp25-rif.yaml

properties:
  reg:
    required: true

  st,proccid:
    type: array
    description: |
      Applicable for platforms implementing the RIF. Used to affect the CID
      number to a particular CPU in EXTI. On STM32MP2x platforms CPU1 = A35,
      CPU2 = M33 and CPU3 = M0+. As EXTI does not know which is the CID for
      each CPU, is must be set.
      For EXTI 1, <1 RIF_CID1>, <2 RIF_CID2>;
      For EXTI 2, <1 RIF_CID1>, <2 RIF_CID2>, <3 RIF_CID3>;

  num-lines:
    type: int
    required: true
    description: Total number of lines supported by the interrupt controller.

  interrupts:
    description: |
      Interrupts references to primary interrupt controller. The order must be aligned
      with line-ranges.

  line-ranges:
    type: array
    required: true
    description: |
      Description of the input lines range for each interrupt line supported
      by the external interrupt controller. For each line a couple of integers is
      provided: the first line of the range start and the length
      of the range.
      As example:
             line-ranges = <0 1>, <1 1>, <2 1>, <3 1>,
                           <4 1>, <5 5>, <10 6>;
      Above property provides event-range for 7 lines.
      5 first lines contain one element
      6th line starts with input line 5 and contains 5 elements (5 to 9)
      7th line starts with input line 10 and contains 6 elements (10 to 15)

  "#interrupt-cells":
    const: 2

interrupt-cells:
  - irq
  - type
```

## platform/ext/target/stm/common/devicetree/bindings/interrupt-controller/st,stm32mp25-pwr-intc.yaml
```yaml
# Copyright (c) 2026, STMicroelectronics - All Rights Reserved
# SPDX-License-Identifier: Apache-2.0

description: |
  STMicroelectronics power control (PWR) provides wake-up pin interrupts.

compatible: "st,stm32mp25-pwr-intc"

include:
  - base.yaml
  - interrupt-controller.yaml

properties:
  "#interrupt-cells":
    const: 2

interrupt-cells:
  - irq
  - type
```

## platform/ext/target/stm/common/devicetree/bindings/memory-controllers/st,stm32-fmc2-ebi.yaml
```yaml
# Copyright (c) 2026, STMicroelectronics - All Rights Reserved
# SPDX-License-Identifier: Apache-2.0

description: |
  The FMC2 functional block makes the interface with: synchronous and
  asynchronous static devices (such as PSNOR, PSRAM or other memory-mapped
  peripherals) and NAND flash memories.
  Its main purposes are:
    - to translate AXI transactions into the appropriate external device
      protocol
    - to meet the access time requirements of the external devices
  All external devices share the addresses, data and control signals with the
  controller. Each external device is accessed by means of a unique Chip
  Select. The FMC2 performs only one access at a time to an external device.

compatible: "st,stm32mp25-fmc2-ebi"

include:
  - base.yaml
  - reset-device.yaml
  - pinctrl-device.yaml
  - st,stm32mp25-rif.yaml

properties:
  reg:
    required: true

  clocks:
    required: true

  pinctrl-0:
    required: true

  st,fmc2-ebi-cs-cclk-enable:
    type: boolean
    description: |
      Continuous clock enable (first bank must be configured
      in synchronous mode). The FMC_CLK is generated continuously
      during asynchronous and synchronous access. By default, the
      FMC_CLK is only generated during synchronous access.

  st,fmc2-ebi-cs-clk-period-ns:
    type: int
    description: |
      This property defines the FMC_CLK output signal period in
      nanoseconds.
```

## platform/ext/target/stm/common/devicetree/bindings/memory-controllers/st,stm32mp21-ramcfg.yaml
```yaml
# Copyright (c) 2026, STMicroelectronics - All Rights Reserved
# SPDX-License-Identifier: Apache-2.0

description: |
  The RAMCFG configures the features of the internal SRAMs (SYSRAM, RETRAM,
  SRAM1 and BKPSRAM).

compatible: "st,stm32mp21-ramcfg"

include:
  - st,stm32mp25-ramcfg.yaml
```

## platform/ext/target/stm/common/devicetree/bindings/memory-controllers/st,stm32mp25-ramcfg.yaml
```yaml
# Copyright (c) 2026, STMicroelectronics - All Rights Reserved
# SPDX-License-Identifier: Apache-2.0

description: |
  The RAMCFG configures the features of the internal SRAMs (SYSRAM, RETRAM,
  SRAM1, SRAM2, LPSRAM1, LPSRAM2, LPSRAM3, BKPSRAM and VDERAM).

compatible: "st,stm32mp25-ramcfg"

include:
  - name: base.yaml
    property-blocklist: [reg]

properties:
  ranges:
    type: array
    required: true

  "#address-cells":
    required: true
    const: 1

  "#size-cells":
    required: true
    const: 1

child-binding:
  description: |
    Each child node represents a block of configuration registers for one
    internal SRAM.
    These should usually look like this:
      ramcfg_<memory>: <memory>-sram@START_OFFSET {
              reg = <0xSTART_OFFSET 0xSIZE>;
      };

  include:
    - name: base.yaml
      property-allowlist: [reg]

  properties:
    reg:
      required: true
```

## platform/ext/target/stm/common/devicetree/bindings/nvmem/nvmem-consumer.yaml
```yaml
# Copyright (c) 2026, STMicroelectronics - All Rights Reserved
# SPDX-License-Identifier: Apache-2.0

properties:
  nvmem-cells:
    type: phandle-array
    description: Non-volatile memory cells
    specifier-space: nvmem-cell

  nvmem-cell-names:
    type: string-array
    description: Provided names of non-volatile memory cells
```

## platform/ext/target/stm/common/devicetree/bindings/nvmem/nvmem-provider.yaml
```yaml
# Copyright (c) 2026, STMicroelectronics - All Rights Reserved
# SPDX-License-Identifier: Apache-2.0

properties:
  "#nvmem-cell-cells":
    type: int
    description: Indicate that a cell can be provided to a consumer, and the number of arguments.
    required: true

  reg:
    type: array
    description: |
      This follow the format <OFFSET SIZE> with OFFSET and SIZE in bytes.
    required: true
```
