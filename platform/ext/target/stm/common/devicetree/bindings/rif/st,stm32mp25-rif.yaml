## platform/ext/target/stm/common/devicetree/bindings/tamper/st,stm32mp25-tamp-nvram.yaml
```yaml
# Copyright (c) 2026, STMicroelectronics - All Rights Reserved
# SPDX-License-Identifier: Apache-2.0

description: |
  The anti-tamper detection circuit exposes 128 32-bit backup registers that are
  retained in all low-power and V-BAT modes.

compatible: "st,stm32mp25-tamp-nvram"

include: [base.yaml, access-device.yaml]

child-binding:
  description: |
    Non volatile memory layouts

    Here is an example:

      nvram0@56010100 {
          compatible = "st,stm32mp25-tamp-nvram";
          reg = <0x56010100 0x200>;
          nvmem-layout {
               #address-cells = <1>;
              #size-cells = <1>;
              nvmem_bckup0: tamp-bkp@0 {
                  #nvmem-cell-cells = <0>;
                  reg = <0x0 0x4>;
              };
              nvmem_bckup1: tamp-bkp@100 {
                  #nvmem-cell-cells = <0>;
                  reg = <0x100 0x4>;
              };
          };
      };

    Note that the usual name for this node is 'nvmem-layout'.
    Above, backup register address 0x0 means that the backup register
    begins at that offset from the parent memory nvmem0's base address.
    That is, backup register addresses are relative; physical addresses
    must be calculated by adding the start address of nvmem0 in memory
    to each backup register's address.

  properties:
    "#address-cells":
      type: int
      description: |
        Number of cells required to represent a child node's
        reg property address. This must be large enough to
        represent the start offset of each backup register.

    "#size-cells":
      type: int
      description: |
        Number of cells required to represent a child node's
        reg property address. This must be large enough to
        represent the size of each backup register in bytes.

  child-binding:
    include: [nvmem-provider.yaml]

    description: |
      Each child node of the fixed-nvmems node represents
      an individual non volatile backup register.
    properties:
      "#nvmem-cell-cells":
        required: true

      reg:
        required: true
```

## platform/ext/target/stm/common/devicetree/bindings/tamper/st,stm32mp25-tamp.yaml
```yaml
# Copyright (c) 2026, STMicroelectronics - All Rights Reserved
# SPDX-License-Identifier: Apache-2.0

description: |
  The anti-tamper detection circuit is used to protect sensitive data from
  external attacks. STM32MP25 has 13 internal and 8 external tamper events.
  128 32-bit backup registers are retained in all low-power modes and also
  in V BAT mode.

compatible: "st,stm32mp25-tamp"

include:
  - st,stm32-tamp.yaml
  - st,stm32mp25-rif.yaml

properties:
  st,tamp-passive-precharge:
    description: 0 is no precharge, so the pull-up is disabled for all external passive tamper.
       1, 2, 3, 4, 8,... defines the number of cycle the STM32 precharge the pin before
       checking the value (low/high) for all external tamper.
    type: int
    enum: [0, 1, 2, 4, 8]

  st,tamp-passive-nb-sample:
    description: The number of sample to read in a row to raise a passive tamper.
    type: int
    enum: [0, 2, 4, 8]

  st,tamp-passive-sample-clk-div:
    description: Clock divider to define frequency to read a sample for a passive tamper.
    type: int
    enum: [256, 512, 1024, 2048, 4096, 8192, 16384, 32768]

  st,tamp-active-filter:
    description: Set the active tamper filtering. 0 when active tamper filtering is disabled.
      1 when active tamper filtering is enabled. A tamper event is detected when 2 comparison
      mismatches occur out of 4 consecutive samples.
    type: int
    enum: [0, 1]

  st,tamp-active-clk-div:
    description: clock divider to define the frequency of read/write cycle for all active tampers.
    type: int
    enum: [1, 2, 4, 8, 16, 32, 64, 128, 2048]

  st,backup-zones:
    type: array
    required: true
    description: |
      Defines the topology of the backup registers zones
      For STM32MP2x platforms, it corresponds to
      <zone1-rif1 zone1-rif2 zone2-rif1 zone2-rif2 zone3-rif1 zone3-rif0 zone3-rif2>;

  st,tamp-internal-tampers:
    type: array
    description:
      List of the internal tamper detection cells to be enabled and whether they
      should be enabled in potential or confirmed mode. Each entry is composed
      of 2 arguments. The first one is the ID of the tamper to activate. The
      second one is the mode.
```

## platform/ext/target/stm/common/devicetree/bindings/timer/st,stm32mp25-timer.yaml
```yaml
# Copyright (c) 2023 STMICROELECTRONICS
# SPDX-License-Identifier: Apache-2.0

description: stm32 timer

compatible: "st,stm32mp25-timers"

include: base.yaml

properties:
  reg:
    required: true

  clocks:
    required: true

  interrupts:
    required: true
```

## platform/ext/target/stm/common/devicetree/bindings/watchdog/st,stm32mp1-iwdg.yaml
```yaml
# Copyright (c) 2026, STMicroelectronics - All Rights Reserved
# SPDX-License-Identifier: Apache-2.0

description: |
  The independent watchdog (IWDG) peripheral offers a high safety level, thanks to its
  capability to detect malfunctions due to software or hardware failures.

  The IWDG is clocked by an independent clock, and stays active even if the main clock fails.

compatible: "st,stm32mp1-iwdg"

include:
  - name: base.yaml
  - name: watchdog.yaml
  - name: reset-device.yaml

properties:
  reg:
    required: true

  clocks:
    required: true

  clock-names:
    required: true
```

## platform/ext/target/stm/common/devicetree/bindings/watchdog/st,stm32mp13-iwdg.yaml
```yaml
# Copyright (c) 2026, STMicroelectronics - All Rights Reserved
# SPDX-License-Identifier: Apache-2.0

compatible: "st,stm32mp13-iwdg"

include: st,stm32mp1-iwdg.yaml
```

## platform/ext/target/stm/common/devicetree/bindings/watchdog/watchdog.yaml
```yaml
# Copyright (c) 2026, STMicroelectronics - All Rights Reserved
# SPDX-License-Identifier: Apache-2.0

# Common fields for watchdog controllers

properties:
  timeout-sec:
    type: int
    description: |
      Contains the watchdog timeout in seconds.
```

## secure_fw/spm/Kconfig.comp
```kconfig
#-------------------------------------------------------------------------------
# Copyright (c) 2022-2023, Arm Limited. All rights reserved.
# Copyright (c) 2023 Cypress Semiconductor Corporation (an Infineon company)
# or an affiliate of Cypress Semiconductor Corporation. All rights reserved.
#
# SPDX-License-Identifier: BSD-3-Clause
#
#-------------------------------------------------------------------------------

menu "TF-M SPM component configs"

config CONFIG_TFM_CONN_HANDLE_MAX_NUM
    int "Maximal number of handling secure services"
    default 8
    help
      The maximal number of secure services that are connected or requested at
      the same time

config CONFIG_TFM_DOORBELL_API
    bool "Enable the doorbell APIs"
    depends on CONFIG_TFM_SPM_BACKEND_IPC
    default n

config CONFIG_TFM_SCHEDULE_WHEN_NS_INTERRUPTED
    bool "Run the scheduler after a secure interrupt pre-empts the NSPE"
    default n

config OTP_NV_COUNTERS_RAM_EMULATION
    bool "Enable OTP/NV_COUNTERS emulation in RAM"
    default n
    depends on PLATFORM_DEFAULT_OTP || PLATFORM_DEFAULT_NV_COUNTERS
    help
      Enable OTP/NV_COUNTERS emulation in RAM. Has no effect on non-default
      implementations of the OTP and NV_COUNTERS

endmenu
```
