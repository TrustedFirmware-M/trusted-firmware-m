## platform/ext/target/stm/common/devicetree/bindings/rif/st,stm32mp25-rif.yaml
```yaml
# Copyright (c) 2026, STMicroelectronics - All Rights Reserved
# SPDX-License-Identifier: Apache-2.0

properties:
  st,protreg:
    type: array
    description: |
      protection value of rif peripherals, each entry is defined by a 32 bit.
```

## platform/ext/target/stm/common/devicetree/bindings/rif/st,stm32mp25-rifsc.yaml
```yaml
# Copyright (c) 2026, STMicroelectronics - All Rights Reserved
# SPDX-License-Identifier: Apache-2.0

description: |
  Resource isolation framework (RIF) is a comprehensive set of hardware blocks
  designed to enforce and manage isolation of STM32 hardware resources like
  memory and peripherals.

  The RIFSC (RIF security controller) is composed of three sets of registers,
  each managing a specific set of hardware resources:
    - RISC registers associated with RISUP logic (resource isolation device unit
      for peripherals), assign all non-RIF aware peripherals to zero, one or
      any security domains (secure, privilege, compartment).
    - RIMC registers: associated with RIMU logic (resource isolation master
      unit), assign all non RIF-aware bus master to one security domain by
      setting secure, privileged and compartment information on the system bus.
      Alternatively, the RISUP logic controlling the device port access to a
      peripheral can assign target bus attributes to this peripheral master port
      (supported attribute: CID).
    - RISC registers associated with RISAL logic (resource isolation device unit
      for address space - Lite version), assign address space subregions to one
      security domains (secure, privilege, compartment).

  On stm32mp25, 15 RIMU are available.

compatible: "st,stm32mp25-rifsc"

include:
  - base.yaml
  - access-controller.yaml
  - st,stm32mp25-rif.yaml

properties:
  reg:
    required: true

  st,glocked:
    type: int
    description:
      Applicable for platforms implementing the RIF. Used to globally lock
      the RIF configuration. When set, Security, privilege, and CID
      configurations are locked and can't be modified until next reset.
      RIMU global lock is enabled with bit 0 and RISUP global lock by
      bit 1.
    enum:
      - 0
      - 1
      - 2
      - 3

  "#access-controller-cells":
    const: 1

  st,rimu:
    type: array
    description:
      protection value of rif master port, each entry is defined by a 32 bit.

  st,errata-ahbrisab:
    type: boolean
    description: |
      If set, a software workaround is set to that the RISAB AHB errata is
      managed. Whenever CID filtering is enabled on either RISAB3/4/5 instances,
      then RIMUs cannot hold the CID0 value on the bus to avoid unwanted access
      rights to some memories.

access-controller-cells:
  - protreg
```

## platform/ext/target/stm/common/devicetree/bindings/rif/st,stm32mp25-risab.yaml
```yaml
# Copyright (c) 2026, STMicroelectronics - All Rights Reserved
# SPDX-License-Identifier: Apache-2.0

description: |
  The RIF (resource isolation framework) is a comprehensive set of hardware
  blocks designed to enforce and manage isolation of STM32 hardware resources,
  like memory and peripherals.
  Through RISAB registers, a trusted domain application, or the application to
  whom the page configuration has been delegated, assigns memory pages to one or
  more security domains (secure, privilege, compartment).

compatible: "st,stm32mp25-risab"

include: [base.yaml, memory-region.yaml]

properties:
  reg:
    required: true

  ranges:
    type: array
    required: true
    description: |
      List the translation areas available for the memory device protected
      by this RISAB instance.

  clocks:
    required: true

  memory-region:
    required: true

  st,srwiad:
    type: boolean
    description: |
      When set, this bit allows secure read/write data accesses to non-secure
      blocks and pages (secure execute remains illegal).

  st,errata-ahbrisab:
    type: boolean
    description: |
      If set, force authorized accessed for CID0 on RISAB protected memories.
      This has to be set if CID filtering is enabled for either RISAB3/4/5
      instances. CID0 must also be prohibited for bus masters system-wide:
      HPDMA channels and RIMUs. This is done to handle bus transactions
      spuriously holding the CID0 when the traffic is dense on these RISAB
      instances. Eventually CID0 is always authorized to handle this case and
      CID0 is prohibited for any bus master to avoid unwanted access to these
      memories.

  st,glock:
    type: boolean
    description: |
      When set, this bit lock all regions configurations.
```

## platform/ext/target/stm/common/devicetree/bindings/rif/st,stm32mp25-risaf-enc.yaml
```yaml
# Copyright (c) 2026, STMicroelectronics - All Rights Reserved
# SPDX-License-Identifier: Apache-2.0

description: |
        RISAF (enc:encode) managing DDR includes the DDR memory cipher engine (DDRMCE) feature.

compatible: "st,stm32mp25-risaf-enc"

include:
   - st,stm32mp25-risaf.yaml
   - entropy-device.yaml

properties:
   entropy:
      required: true
```

## platform/ext/target/stm/common/devicetree/bindings/rif/st,stm32mp25-risaf.yaml
```yaml
# Copyright (c) 2026, STMicroelectronics - All Rights Reserved
# SPDX-License-Identifier: Apache-2.0

description: |
  The RIF (resource isolation framework) is a comprehensive set of hardware
  blocks designed to enforce and manage isolation of STM32 hardware resources,
  like memory and peripherals.
  Through RISAF registers, a trusted domain application, or the application to
  whom the configuration has been delegated, assigns memory regions and
  subregions to one or more security domains (secure, privilege, compartment).
  RISAF managing DRR includes the DDR memory cipher engine (DDRMCE) feature.

compatible: "st,stm32mp25-risaf"

include:
  - base.yaml
  - access-device.yaml
  - memory-region.yaml
  - access-controller.yaml

properties:
  reg:
    required: true

  clocks:
    required: true

  memory-region:
    required: true

  "#access-controller-cells":
    const: 2

  st,mem-map:
    type: array
    description: |
      Defines the memory range covered by the RISAF.

access-controller-cells:
  - region
  - protreg
```

## platform/ext/target/stm/common/devicetree/bindings/rif/st,stm32mp25-serc.yaml
```yaml
# Copyright (c) 2026, STMicroelectronics - All Rights Reserved
# SPDX-License-Identifier: Apache-2.0

description: |
  The RIF (resource isolation framework) is a comprehensive set of hardware blocks
  designed to enforce and manage isolation of STM32 hardware resources such as memory
  and peripherals.

  The RIF uses the SERC (Software error robustness collector) to detects accesses on target peripherals
  that are either shutdown (computing clock off), or under reset. Managed by a secure application
  running in the trusted domain.

compatible: "st,stm32mp25-serc"

include: base.yaml

properties:
  reg:
    required: true

  interrupts:
    required: true

  id_disable:
    type: array
    description: rif index which can be disabled (no irq occurs)
```

## platform/ext/target/stm/common/devicetree/bindings/rtc/st,stm32mp25-rtc.yaml
```yaml
# Copyright (c) 2026, STMicroelectronics - All Rights Reserved
# SPDX-License-Identifier: Apache-2.0

description: STMicroelectronics STM32 RTC

compatible: "st,stm32mp25-rtc"

include:
  - base.yaml
  - st,stm32mp25-rif.yaml

properties:
  reg:
    required: true

  clocks:
    required: true
```

## platform/ext/target/stm/common/devicetree/bindings/serial/st,stm32h7-uart.yaml
```yaml
# Copyright (c) 2026, STMicroelectronics - All Rights Reserved
# SPDX-License-Identifier: Apache-2.0

description: STMicroelectronics STM32 UART

compatible: "st,stm32h7-uart"

include:
  - name: base.yaml
  - name: reset-device.yaml
  - name: pinctrl-device.yaml
  - name: uart-controller.yaml
    property-allowlist:
      - current-speed
      - parity
      - stop-bits
      - data-bits
      - flow-ctrl

properties:
  reg:
    required: true

  clocks:
    required: true

  pinctrl-0:
    required: true

  pinctrl-names:
    required: true
```

## platform/ext/target/stm/common/devicetree/bindings/spi/st,stm32mp25-ospi.yaml
```yaml
# Copyright (c) 2020 STMICROELECTRONICS
# SPDX-License-Identifier: Apache-2.0

description: |
  STM32 OSPI Memory Interface allows a SPI flash or HyperFlash connected to
  the SoC to be accessed via the external address space.

  The flash chip itself should be represented by a subnode of the STM32 OSPI
  Memory Interface node. The flash interface is selected based on the
  "compatible" property of this subnode:
  - if it contains "jedec,spi-nor", then SPI is used;
  - if it contains "spi-nand", then SPI is used.
  - if it contains "cfi-flash", then HyperFlash is used.

compatible: "st,stm32mp25-ospi"

include:
  - base.yaml
  - pinctrl-device.yaml
  - reset-device.yaml
  - memory-region.yaml
  - name: st,stm32mp25-syscfg-properties.yaml
    property-allowlist:
      - st,syscfg-dlyb

properties:
  reg:
    required: true

  clocks:
    required: true

  resets:
    required: true

  st,syscfg-dlyb:
    required: true
```

## platform/ext/target/stm/common/devicetree/bindings/syscon/st,stm32mp21-syscfg-properties.yaml
```yaml
# Copyright (c) 2026, STMicroelectronics - All Rights Reserved
# SPDX-License-Identifier: Apache-2.0

description: stm32 system configuration properties for stm32mp21

include:
  - name: st,stm32mp25-syscfg-properties.yaml
    property-allowlist:
      - st,syscfg-dlyb
      - st,syscfg-vddio

properties:

  st,syscfg-arcr:
    type: phandle-array
    specifier-space: syscfg-reg-mask
    description: |
      Phandle to system configuration controller. It is used to get the status of the STM32 DMA3 AXI
      port address remapping. When enabled, the 4GB address space accessible by the STM32 DMA3 AXI
      port starts at address 0x80000000 instead of 0x00000000.
```

## platform/ext/target/stm/common/devicetree/bindings/syscon/st,stm32mp21-syscfg.yaml
```yaml
# Copyright (c) 2026, STMicroelectronics - All Rights Reserved
# SPDX-License-Identifier: Apache-2.0

description: |
  STM32 System configuration controller (SYSCFG) in STM32MP21 SoC inherits of
  the features described in st,stm32mp25-syscfg.yaml. This version support less
  registers.

compatible: "st,stm32mp21-syscfg"

include:
  - st,stm32mp25-syscfg.yaml
```

## platform/ext/target/stm/common/devicetree/bindings/syscon/st,stm32mp25-syscfg-properties.yaml
```yaml
# Copyright (c) 2026, STMicroelectronics - All Rights Reserved
# SPDX-License-Identifier: Apache-2.0

description: stm32 system configuration properties

properties:

  st,syscfg-dlyb:
    type: phandle-array
    specifier-space: syscfg-reg
    description: |
      Use to set the OSPI delay block within SYSCFG to:
        - Tune the phase of the RX sampling clock (or DQS) in order
        to sample the data in their valid window.
        - Tune the phase of the TX launch clock in order to meet setup
        and hold constraints of TX signals versus the memory clock.

  st,syscfg-amcr:
    type: phandle-array
    specifier-space: syscfg-reg-mask
    description: The Address Mapping Control Register (AMCR) is used
      to split the 256MB memory map area shared between the 2 OSPI
      Memory Interface (OMI). The Octo Memory Manager sets the AMCR
      depending of the memory-region configuration.

  st,syscfg-vddio:
    type: phandle-array
    specifier-space: syscfg-reg
    description: Use to enable / disable IO compensation for vddio's.
```

## platform/ext/target/stm/common/devicetree/bindings/syscon/st,stm32mp25-syscfg.yaml
```yaml
# Copyright (c) 2026, STMicroelectronics - All Rights Reserved
# SPDX-License-Identifier: Apache-2.0

description: |
  STM32 System configuration controller (SYSCFG) node.

compatible: "st,stm32mp25-syscfg"

include: [syscon.yaml]

properties:
  st,reg-init:
    type: array
    description: |
      This property can be used if the register cannot be set by framework
      or driver through the syscon API. Each register is defined by <offset value>.

  "#syscfg-reg-cells":
    type: int
    const: 1

  "#syscfg-reg-mask-cells":
    type: int
    const: 2

syscfg-reg-cells:
  - offset

syscfg-reg-mask-cells:
  - offset
  - mask
```

## platform/ext/target/stm/common/devicetree/bindings/tamper/st,stm32-tamp-external.yaml
```yaml
# Copyright (c) 2026, STMicroelectronics - All Rights Reserved
# SPDX-License-Identifier: Apache-2.0

description: |
  External tamper event circuit is used to protect soc and board attacks.

compatible: "st,stm32-tamp-external"

include:
  - base.yaml

properties:
  st,tamp-mode:
    required: true
    type: int
    enum:
      - 1 # TAMPER_CONFIRMED_MODE
      - 2 # TAMPER_POTENTIAL_MODE
    description: |
      Each tamper can be configured in two modes
      - Confirmed mode: immediate erase of secrets on tamper detection, including
                        backup registers erase
      - Potential mode: most of the secrets erase following a tamper detection are
                        launched by software

  st,tamp-id:
    required: true
    type: array
    description: |
      IDs of a tamper event. The external I/Os tamper detection supports 2 main configurations:
      - Passive mode: TAMP_INx is monitored and a tamper is detected either on edge or on level
        (only one id is needed).
      - Active mode: TAMP_INx (in id x) is continuously compared with TAMP_OUTy (out id y)
        allowing open-short detection (2 id needed in and out).

  st,trig-on:
    type: boolean
    description: Defines the active level to activate this passive tamper
      (not used if tamper-gpios has 2 entries).
      It also depends on st,tamp-passive-precharge value. When st,tamp-passive-precharge=0
      this passive tamper activates at edge. When st,tamp-passive-precharge != 0, with st,trig-on
      defined, this passive tamper will activate if st,tamp-passive-nb-sample in a row are high.
      If not defined the passive tamper event is raised if st,tamp-passive-nb-sample in a row
      are low.

  tamper-gpios:
    required: true
    type: phandle-array
    description: GPIOs used for the external tamper
```

## platform/ext/target/stm/common/devicetree/bindings/tamper/st,stm32-tamp.yaml
```yaml
# Copyright (c) 2026, STMicroelectronics - All Rights Reserved
# SPDX-License-Identifier: Apache-2.0

description: |
  The anti-tamper detection circuit is used to protect sensitive data from
  external attacks. 128 32-bit backup registers are retained in all low-power
  modes and also in V BAT mode.

compatible: "st,stm32-tamp"

include:
  - base.yaml
  - gpio-controller.yaml

properties:
  reg:
    required: true

  clocks:
    required: true

  "#gpio-cells":
    const: 2

gpio-cells:
  - pin
  - flags
```

## platform/ext/target/stm/common/devicetree/bindings/tamper/st,stm32mp21-tamp.yaml
```yaml
# Copyright (c) 2026, STMicroelectronics - All Rights Reserved
# SPDX-License-Identifier: Apache-2.0

description: |
  The anti-tamper detection circuit is used to protect sensitive data from
  external attacks. STM32MP21 has 16 internal and 7 external tamper events.
  128 32-bit backup registers are retained in all low-power modes and also
  in V BAT mode.

compatible: "st,stm32mp21-tamp"

include:
  - st,stm32mp25-tamp.yaml
```
