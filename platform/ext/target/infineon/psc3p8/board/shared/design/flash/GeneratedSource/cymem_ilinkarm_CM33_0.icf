// This file is automatically generated.
define exported symbol CYMEM_CM33_0_m33s_nvm_START = 0x22014800;
define exported symbol CYMEM_CM33_0_m33s_nvm_C_START = 0x02014800;
define exported symbol CYMEM_CM33_0_m33s_nvm_SIZE = 0x0002B000;
define exported symbol CYMEM_CM33_0_m33s_nvm_OFFSET = 0x00014800;
define exported symbol CYMEM_CM33_0_m33s_nvm_sel_START = CYMEM_CM33_0_m33s_nvm_C_START;
define exported symbol CYMEM_CM33_0_TFM_ITS_START = 0x2203F800;
define exported symbol CYMEM_CM33_0_TFM_ITS_C_START = 0x0203F800;
define exported symbol CYMEM_CM33_0_TFM_ITS_SIZE = 0x00001000;
define exported symbol CYMEM_CM33_0_TFM_ITS_OFFSET = 0x0003F800;
define exported symbol CYMEM_CM33_0_TFM_ITS_sel_START = CYMEM_CM33_0_TFM_ITS_C_START;
define exported symbol CYMEM_CM33_0_TFM_PS_START = 0x22040800;
define exported symbol CYMEM_CM33_0_TFM_PS_C_START = 0x02040800;
define exported symbol CYMEM_CM33_0_TFM_PS_SIZE = 0x00002000;
define exported symbol CYMEM_CM33_0_TFM_PS_OFFSET = 0x00040800;
define exported symbol CYMEM_CM33_0_TFM_PS_sel_START = CYMEM_CM33_0_TFM_PS_C_START;
define exported symbol CYMEM_CM33_0_TFM_NV_COUNTERS_START = 0x22042800;
define exported symbol CYMEM_CM33_0_TFM_NV_COUNTERS_C_START = 0x02042800;
define exported symbol CYMEM_CM33_0_TFM_NV_COUNTERS_SIZE = 0x00000800;
define exported symbol CYMEM_CM33_0_TFM_NV_COUNTERS_OFFSET = 0x00042800;
define exported symbol CYMEM_CM33_0_TFM_NV_COUNTERS_sel_START = CYMEM_CM33_0_TFM_NV_COUNTERS_C_START;
define exported symbol CYMEM_CM33_0_m33ns_nvm_START = 0x22043000;
define exported symbol CYMEM_CM33_0_m33ns_nvm_C_START = 0x02043000;
define exported symbol CYMEM_CM33_0_m33ns_nvm_SIZE = 0x00008C00;
define exported symbol CYMEM_CM33_0_m33ns_nvm_OFFSET = 0x00043000;
define exported symbol CYMEM_CM33_0_m33ns_nvm_sel_START = CYMEM_CM33_0_m33ns_nvm_C_START;
define exported symbol CYMEM_CM33_0_m33s_nvm_secondary_slot_START = 0x2204BC00;
define exported symbol CYMEM_CM33_0_m33s_nvm_secondary_slot_C_START = 0x0204BC00;
define exported symbol CYMEM_CM33_0_m33s_nvm_secondary_slot_SIZE = 0x0002B000;
define exported symbol CYMEM_CM33_0_m33s_nvm_secondary_slot_OFFSET = 0x0004BC00;
define exported symbol CYMEM_CM33_0_m33s_nvm_secondary_slot_sel_START = CYMEM_CM33_0_m33s_nvm_secondary_slot_C_START;
define exported symbol CYMEM_CM33_0_m33ns_nvm_secondary_slot_START = 0x22076C00;
define exported symbol CYMEM_CM33_0_m33ns_nvm_secondary_slot_C_START = 0x02076C00;
define exported symbol CYMEM_CM33_0_m33ns_nvm_secondary_slot_SIZE = 0x00008C00;
define exported symbol CYMEM_CM33_0_m33ns_nvm_secondary_slot_OFFSET = 0x00076C00;
define exported symbol CYMEM_CM33_0_m33ns_nvm_secondary_slot_sel_START = CYMEM_CM33_0_m33ns_nvm_secondary_slot_C_START;
define exported symbol CYMEM_CM33_0_m33ns_ppca0_nvm_START = 0x2207F800;
define exported symbol CYMEM_CM33_0_m33ns_ppca0_nvm_C_START = 0x0207F800;
define exported symbol CYMEM_CM33_0_m33ns_ppca0_nvm_SIZE = 0x00000400;
define exported symbol CYMEM_CM33_0_m33ns_ppca0_nvm_OFFSET = 0x0007F800;
define exported symbol CYMEM_CM33_0_m33ns_ppca0_nvm_sel_START = CYMEM_CM33_0_m33ns_ppca0_nvm_C_START;
define exported symbol CYMEM_CM33_0_m33ns_ppca1_nvm_START = 0x2207FC00;
define exported symbol CYMEM_CM33_0_m33ns_ppca1_nvm_C_START = 0x0207FC00;
define exported symbol CYMEM_CM33_0_m33ns_ppca1_nvm_SIZE = 0x00000400;
define exported symbol CYMEM_CM33_0_m33ns_ppca1_nvm_OFFSET = 0x0007FC00;
define exported symbol CYMEM_CM33_0_m33ns_ppca1_nvm_sel_START = CYMEM_CM33_0_m33ns_ppca1_nvm_C_START;
define exported symbol CYMEM_CM33_0_ppca0_code_SIZE = 0x00007FFC;
define exported symbol CYMEM_CM33_0_ppca0_code_OFFSET = 0x00000000;
define exported symbol CYMEM_CM33_0_ppca0_crc_SIZE = 0x00000004;
define exported symbol CYMEM_CM33_0_ppca0_crc_OFFSET = 0x00007FFC;
define exported symbol CYMEM_CM33_0_ppca0_data_START = 0x43020000;
define exported symbol CYMEM_CM33_0_ppca0_data_SIZE = 0x00004000;
define exported symbol CYMEM_CM33_0_ppca0_data_OFFSET = 0x00000000;
define exported symbol CYMEM_CM33_0_ppca0_data_sel_START = CYMEM_CM33_0_ppca0_data_START;
define exported symbol CYMEM_CM33_0_ppca1_code_SIZE = 0x00007FFC;
define exported symbol CYMEM_CM33_0_ppca1_code_OFFSET = 0x00000000;
define exported symbol CYMEM_CM33_0_ppca1_crc_SIZE = 0x00000004;
define exported symbol CYMEM_CM33_0_ppca1_crc_OFFSET = 0x00007FFC;
define exported symbol CYMEM_CM33_0_ppca1_data_START = 0x43040000;
define exported symbol CYMEM_CM33_0_ppca1_data_SIZE = 0x00004000;
define exported symbol CYMEM_CM33_0_ppca1_data_OFFSET = 0x00000000;
define exported symbol CYMEM_CM33_0_ppca1_data_sel_START = CYMEM_CM33_0_ppca1_data_START;
define exported symbol CYMEM_CM33_0_ppca_shm_data_START = 0x43050000;
define exported symbol CYMEM_CM33_0_ppca_shm_data_SIZE = 0x00004000;
define exported symbol CYMEM_CM33_0_ppca_shm_data_OFFSET = 0x00000000;
define exported symbol CYMEM_CM33_0_ppca_shm_data_sel_START = CYMEM_CM33_0_ppca_shm_data_START;
define exported symbol CYMEM_CM33_0_m33s_shared_START = 0x24000000;
define exported symbol CYMEM_CM33_0_m33s_shared_C_START = 0x04000000;
define exported symbol CYMEM_CM33_0_m33s_shared_SIZE = 0x00001000;
define exported symbol CYMEM_CM33_0_m33s_shared_OFFSET = 0x00000000;
define exported symbol CYMEM_CM33_0_m33s_shared_sel_START = CYMEM_CM33_0_m33s_shared_C_START;
define exported symbol CYMEM_CM33_0_m33s_data_START = 0x24001000;
define exported symbol CYMEM_CM33_0_m33s_data_C_START = 0x04001000;
define exported symbol CYMEM_CM33_0_m33s_data_SIZE = 0x00016000;
define exported symbol CYMEM_CM33_0_m33s_data_OFFSET = 0x00001000;
define exported symbol CYMEM_CM33_0_m33s_data_sel_START = CYMEM_CM33_0_m33s_data_C_START;
define exported symbol CYMEM_CM33_0_m33s_shm_data_START = 0x24017000;
define exported symbol CYMEM_CM33_0_m33s_shm_data_C_START = 0x04017000;
define exported symbol CYMEM_CM33_0_m33s_shm_data_SIZE = 0x00000800;
define exported symbol CYMEM_CM33_0_m33s_shm_data_OFFSET = 0x00017000;
define exported symbol CYMEM_CM33_0_m33s_shm_data_sel_START = CYMEM_CM33_0_m33s_shm_data_C_START;
define exported symbol CYMEM_CM33_0_m33ns_data_START = 0x24017800;
define exported symbol CYMEM_CM33_0_m33ns_data_C_START = 0x04017800;
define exported symbol CYMEM_CM33_0_m33ns_data_SIZE = 0x00008000;
define exported symbol CYMEM_CM33_0_m33ns_data_OFFSET = 0x00017800;
define exported symbol CYMEM_CM33_0_m33ns_data_sel_START = CYMEM_CM33_0_m33ns_data_C_START;
define exported symbol CYMEM_CM33_0_m33ns_shm_data_START = 0x2401F800;
define exported symbol CYMEM_CM33_0_m33ns_shm_data_C_START = 0x0401F800;
define exported symbol CYMEM_CM33_0_m33ns_shm_data_SIZE = 0x00000800;
define exported symbol CYMEM_CM33_0_m33ns_shm_data_OFFSET = 0x0001F800;
define exported symbol CYMEM_CM33_0_m33ns_shm_data_sel_START = CYMEM_CM33_0_m33ns_shm_data_C_START;
