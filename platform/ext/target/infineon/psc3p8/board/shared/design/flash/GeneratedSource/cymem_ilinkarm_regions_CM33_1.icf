// This file is automatically generated.
// define memory with size = 4G;
define region m33s_nvm = [from CYMEM_CM33_1_m33s_nvm_START size CYMEM_CM33_1_m33s_nvm_SIZE];
define region m33s_nvm_sel = [from CYMEM_CM33_1_m33s_nvm_START size CYMEM_CM33_1_m33s_nvm_SIZE];
define region TFM_ITS = [from CYMEM_CM33_1_TFM_ITS_START size CYMEM_CM33_1_TFM_ITS_SIZE];
define region TFM_ITS_sel = [from CYMEM_CM33_1_TFM_ITS_START size CYMEM_CM33_1_TFM_ITS_SIZE];
define region TFM_PS = [from CYMEM_CM33_1_TFM_PS_START size CYMEM_CM33_1_TFM_PS_SIZE];
define region TFM_PS_sel = [from CYMEM_CM33_1_TFM_PS_START size CYMEM_CM33_1_TFM_PS_SIZE];
define region TFM_NV_COUNTERS = [from CYMEM_CM33_1_TFM_NV_COUNTERS_START size CYMEM_CM33_1_TFM_NV_COUNTERS_SIZE];
define region TFM_NV_COUNTERS_sel = [from CYMEM_CM33_1_TFM_NV_COUNTERS_START size CYMEM_CM33_1_TFM_NV_COUNTERS_SIZE];
define region m33ns_nvm = [from CYMEM_CM33_1_m33ns_nvm_START size CYMEM_CM33_1_m33ns_nvm_SIZE];
define region m33ns_nvm_sel = [from CYMEM_CM33_1_m33ns_nvm_START size CYMEM_CM33_1_m33ns_nvm_SIZE];
define region m33s_nvm_secondary_slot = [from CYMEM_CM33_1_m33s_nvm_secondary_slot_START size CYMEM_CM33_1_m33s_nvm_secondary_slot_SIZE];
define region m33s_nvm_secondary_slot_sel = [from CYMEM_CM33_1_m33s_nvm_secondary_slot_START size CYMEM_CM33_1_m33s_nvm_secondary_slot_SIZE];
define region m33ns_nvm_secondary_slot = [from CYMEM_CM33_1_m33ns_nvm_secondary_slot_START size CYMEM_CM33_1_m33ns_nvm_secondary_slot_SIZE];
define region m33ns_nvm_secondary_slot_sel = [from CYMEM_CM33_1_m33ns_nvm_secondary_slot_START size CYMEM_CM33_1_m33ns_nvm_secondary_slot_SIZE];
define region m33ns_ppca0_nvm = [from CYMEM_CM33_1_m33ns_ppca0_nvm_START size CYMEM_CM33_1_m33ns_ppca0_nvm_SIZE];
define region m33ns_ppca0_nvm_sel = [from CYMEM_CM33_1_m33ns_ppca0_nvm_START size CYMEM_CM33_1_m33ns_ppca0_nvm_SIZE];
define region m33ns_ppca1_nvm = [from CYMEM_CM33_1_m33ns_ppca1_nvm_START size CYMEM_CM33_1_m33ns_ppca1_nvm_SIZE];
define region m33ns_ppca1_nvm_sel = [from CYMEM_CM33_1_m33ns_ppca1_nvm_START size CYMEM_CM33_1_m33ns_ppca1_nvm_SIZE];
define region ppca0_code = [from CYMEM_CM33_1_ppca0_code_START size CYMEM_CM33_1_ppca0_code_SIZE];
define region ppca0_code_sel = [from CYMEM_CM33_1_ppca0_code_START size CYMEM_CM33_1_ppca0_code_SIZE];
define region ppca0_crc = [from CYMEM_CM33_1_ppca0_crc_START size CYMEM_CM33_1_ppca0_crc_SIZE];
define region ppca0_crc_sel = [from CYMEM_CM33_1_ppca0_crc_START size CYMEM_CM33_1_ppca0_crc_SIZE];
define region ppca0_data = [from CYMEM_CM33_1_ppca0_data_START size CYMEM_CM33_1_ppca0_data_SIZE];
define region ppca0_data_sel = [from CYMEM_CM33_1_ppca0_data_START size CYMEM_CM33_1_ppca0_data_SIZE];
define region ppca_shm_data = [from CYMEM_CM33_1_ppca_shm_data_START size CYMEM_CM33_1_ppca_shm_data_SIZE];
define region ppca_shm_data_sel = [from CYMEM_CM33_1_ppca_shm_data_START size CYMEM_CM33_1_ppca_shm_data_SIZE];
