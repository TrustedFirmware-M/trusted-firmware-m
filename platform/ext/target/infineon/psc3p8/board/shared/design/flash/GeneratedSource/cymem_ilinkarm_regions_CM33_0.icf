// This file is automatically generated.
// define memory with size = 4G;
define region m33s_nvm = [from CYMEM_CM33_0_m33s_nvm_START size CYMEM_CM33_0_m33s_nvm_SIZE];
define region m33s_nvm_C = [from CYMEM_CM33_0_m33s_nvm_C_START size CYMEM_CM33_0_m33s_nvm_SIZE];
define region m33s_nvm_sel = [from CYMEM_CM33_0_m33s_nvm_C_START size CYMEM_CM33_0_m33s_nvm_SIZE];
define region TFM_ITS = [from CYMEM_CM33_0_TFM_ITS_START size CYMEM_CM33_0_TFM_ITS_SIZE];
define region TFM_ITS_C = [from CYMEM_CM33_0_TFM_ITS_C_START size CYMEM_CM33_0_TFM_ITS_SIZE];
define region TFM_ITS_sel = [from CYMEM_CM33_0_TFM_ITS_C_START size CYMEM_CM33_0_TFM_ITS_SIZE];
define region TFM_PS = [from CYMEM_CM33_0_TFM_PS_START size CYMEM_CM33_0_TFM_PS_SIZE];
define region TFM_PS_C = [from CYMEM_CM33_0_TFM_PS_C_START size CYMEM_CM33_0_TFM_PS_SIZE];
define region TFM_PS_sel = [from CYMEM_CM33_0_TFM_PS_C_START size CYMEM_CM33_0_TFM_PS_SIZE];
define region TFM_NV_COUNTERS = [from CYMEM_CM33_0_TFM_NV_COUNTERS_START size CYMEM_CM33_0_TFM_NV_COUNTERS_SIZE];
define region TFM_NV_COUNTERS_C = [from CYMEM_CM33_0_TFM_NV_COUNTERS_C_START size CYMEM_CM33_0_TFM_NV_COUNTERS_SIZE];
define region TFM_NV_COUNTERS_sel = [from CYMEM_CM33_0_TFM_NV_COUNTERS_C_START size CYMEM_CM33_0_TFM_NV_COUNTERS_SIZE];
define region m33ns_nvm = [from CYMEM_CM33_0_m33ns_nvm_START size CYMEM_CM33_0_m33ns_nvm_SIZE];
define region m33ns_nvm_C = [from CYMEM_CM33_0_m33ns_nvm_C_START size CYMEM_CM33_0_m33ns_nvm_SIZE];
define region m33ns_nvm_sel = [from CYMEM_CM33_0_m33ns_nvm_C_START size CYMEM_CM33_0_m33ns_nvm_SIZE];
define region m33s_nvm_secondary_slot = [from CYMEM_CM33_0_m33s_nvm_secondary_slot_START size CYMEM_CM33_0_m33s_nvm_secondary_slot_SIZE];
define region m33s_nvm_secondary_slot_C = [from CYMEM_CM33_0_m33s_nvm_secondary_slot_C_START size CYMEM_CM33_0_m33s_nvm_secondary_slot_SIZE];
define region m33s_nvm_secondary_slot_sel = [from CYMEM_CM33_0_m33s_nvm_secondary_slot_C_START size CYMEM_CM33_0_m33s_nvm_secondary_slot_SIZE];
define region m33ns_nvm_secondary_slot = [from CYMEM_CM33_0_m33ns_nvm_secondary_slot_START size CYMEM_CM33_0_m33ns_nvm_secondary_slot_SIZE];
define region m33ns_nvm_secondary_slot_C = [from CYMEM_CM33_0_m33ns_nvm_secondary_slot_C_START size CYMEM_CM33_0_m33ns_nvm_secondary_slot_SIZE];
define region m33ns_nvm_secondary_slot_sel = [from CYMEM_CM33_0_m33ns_nvm_secondary_slot_C_START size CYMEM_CM33_0_m33ns_nvm_secondary_slot_SIZE];
define region m33ns_ppca0_nvm = [from CYMEM_CM33_0_m33ns_ppca0_nvm_START size CYMEM_CM33_0_m33ns_ppca0_nvm_SIZE];
define region m33ns_ppca0_nvm_C = [from CYMEM_CM33_0_m33ns_ppca0_nvm_C_START size CYMEM_CM33_0_m33ns_ppca0_nvm_SIZE];
define region m33ns_ppca0_nvm_sel = [from CYMEM_CM33_0_m33ns_ppca0_nvm_C_START size CYMEM_CM33_0_m33ns_ppca0_nvm_SIZE];
define region m33ns_ppca1_nvm = [from CYMEM_CM33_0_m33ns_ppca1_nvm_START size CYMEM_CM33_0_m33ns_ppca1_nvm_SIZE];
define region m33ns_ppca1_nvm_C = [from CYMEM_CM33_0_m33ns_ppca1_nvm_C_START size CYMEM_CM33_0_m33ns_ppca1_nvm_SIZE];
define region m33ns_ppca1_nvm_sel = [from CYMEM_CM33_0_m33ns_ppca1_nvm_C_START size CYMEM_CM33_0_m33ns_ppca1_nvm_SIZE];
define region ppca0_data = [from CYMEM_CM33_0_ppca0_data_START size CYMEM_CM33_0_ppca0_data_SIZE];
define region ppca0_data_sel = [from CYMEM_CM33_0_ppca0_data_START size CYMEM_CM33_0_ppca0_data_SIZE];
define region ppca1_data = [from CYMEM_CM33_0_ppca1_data_START size CYMEM_CM33_0_ppca1_data_SIZE];
define region ppca1_data_sel = [from CYMEM_CM33_0_ppca1_data_START size CYMEM_CM33_0_ppca1_data_SIZE];
define region ppca_shm_data = [from CYMEM_CM33_0_ppca_shm_data_START size CYMEM_CM33_0_ppca_shm_data_SIZE];
define region ppca_shm_data_sel = [from CYMEM_CM33_0_ppca_shm_data_START size CYMEM_CM33_0_ppca_shm_data_SIZE];
define region m33s_shared = [from CYMEM_CM33_0_m33s_shared_START size CYMEM_CM33_0_m33s_shared_SIZE];
define region m33s_shared_C = [from CYMEM_CM33_0_m33s_shared_C_START size CYMEM_CM33_0_m33s_shared_SIZE];
define region m33s_shared_sel = [from CYMEM_CM33_0_m33s_shared_C_START size CYMEM_CM33_0_m33s_shared_SIZE];
define region m33s_data = [from CYMEM_CM33_0_m33s_data_START size CYMEM_CM33_0_m33s_data_SIZE];
define region m33s_data_C = [from CYMEM_CM33_0_m33s_data_C_START size CYMEM_CM33_0_m33s_data_SIZE];
define region m33s_data_sel = [from CYMEM_CM33_0_m33s_data_C_START size CYMEM_CM33_0_m33s_data_SIZE];
define region m33s_shm_data = [from CYMEM_CM33_0_m33s_shm_data_START size CYMEM_CM33_0_m33s_shm_data_SIZE];
define region m33s_shm_data_C = [from CYMEM_CM33_0_m33s_shm_data_C_START size CYMEM_CM33_0_m33s_shm_data_SIZE];
define region m33s_shm_data_sel = [from CYMEM_CM33_0_m33s_shm_data_C_START size CYMEM_CM33_0_m33s_shm_data_SIZE];
define region m33ns_data = [from CYMEM_CM33_0_m33ns_data_START size CYMEM_CM33_0_m33ns_data_SIZE];
define region m33ns_data_C = [from CYMEM_CM33_0_m33ns_data_C_START size CYMEM_CM33_0_m33ns_data_SIZE];
define region m33ns_data_sel = [from CYMEM_CM33_0_m33ns_data_C_START size CYMEM_CM33_0_m33ns_data_SIZE];
define region m33ns_shm_data = [from CYMEM_CM33_0_m33ns_shm_data_START size CYMEM_CM33_0_m33ns_shm_data_SIZE];
define region m33ns_shm_data_C = [from CYMEM_CM33_0_m33ns_shm_data_C_START size CYMEM_CM33_0_m33ns_shm_data_SIZE];
define region m33ns_shm_data_sel = [from CYMEM_CM33_0_m33ns_shm_data_C_START size CYMEM_CM33_0_m33ns_shm_data_SIZE];
