// This file is automatically generated.
define exported symbol CYMEM_CM33_0_S_TFM_NV_COUNTERS_START = 0x22014800;
define exported symbol CYMEM_CM33_0_S_TFM_NV_COUNTERS_C_START = 0x02014800;
define exported symbol CYMEM_CM33_0_S_TFM_NV_COUNTERS_C_S_START = 0x12014800;
define exported symbol CYMEM_CM33_0_S_TFM_NV_COUNTERS_S_START = 0x32014800;
define exported symbol CYMEM_CM33_0_S_TFM_NV_COUNTERS_SIZE = 0x00000800;
define exported symbol CYMEM_CM33_0_S_TFM_NV_COUNTERS_OFFSET = 0x00014800;
define exported symbol CYMEM_CM33_0_S_TFM_NV_COUNTERS_sel_START = CYMEM_CM33_0_S_TFM_NV_COUNTERS_C_START;
define exported symbol CYMEM_CM33_0_S_TFM_NV_COUNTERS_sel_S_START = CYMEM_CM33_0_S_TFM_NV_COUNTERS_C_S_START;
define exported symbol CYMEM_CM33_0_S_TFM_ITS_START = 0x22015000;
define exported symbol CYMEM_CM33_0_S_TFM_ITS_C_START = 0x02015000;
define exported symbol CYMEM_CM33_0_S_TFM_ITS_C_S_START = 0x12015000;
define exported symbol CYMEM_CM33_0_S_TFM_ITS_S_START = 0x32015000;
define exported symbol CYMEM_CM33_0_S_TFM_ITS_SIZE = 0x00001000;
define exported symbol CYMEM_CM33_0_S_TFM_ITS_OFFSET = 0x00015000;
define exported symbol CYMEM_CM33_0_S_TFM_ITS_sel_START = CYMEM_CM33_0_S_TFM_ITS_C_START;
define exported symbol CYMEM_CM33_0_S_TFM_ITS_sel_S_START = CYMEM_CM33_0_S_TFM_ITS_C_S_START;
define exported symbol CYMEM_CM33_0_S_TFM_PS_START = 0x22016000;
define exported symbol CYMEM_CM33_0_S_TFM_PS_C_START = 0x02016000;
define exported symbol CYMEM_CM33_0_S_TFM_PS_C_S_START = 0x12016000;
define exported symbol CYMEM_CM33_0_S_TFM_PS_S_START = 0x32016000;
define exported symbol CYMEM_CM33_0_S_TFM_PS_SIZE = 0x00002000;
define exported symbol CYMEM_CM33_0_S_TFM_PS_OFFSET = 0x00016000;
define exported symbol CYMEM_CM33_0_S_TFM_PS_sel_START = CYMEM_CM33_0_S_TFM_PS_C_START;
define exported symbol CYMEM_CM33_0_S_TFM_PS_sel_S_START = CYMEM_CM33_0_S_TFM_PS_C_S_START;
define exported symbol CYMEM_CM33_0_S_m33_nvm_START = 0x22018000;
define exported symbol CYMEM_CM33_0_S_m33_nvm_C_START = 0x02018000;
define exported symbol CYMEM_CM33_0_S_m33_nvm_C_S_START = 0x12018000;
define exported symbol CYMEM_CM33_0_S_m33_nvm_S_START = 0x32018000;
define exported symbol CYMEM_CM33_0_S_m33_nvm_SIZE = 0x0002B800;
define exported symbol CYMEM_CM33_0_S_m33_nvm_OFFSET = 0x00018000;
define exported symbol CYMEM_CM33_0_S_m33_nvm_sel_START = CYMEM_CM33_0_S_m33_nvm_C_START;
define exported symbol CYMEM_CM33_0_S_m33_nvm_sel_S_START = CYMEM_CM33_0_S_m33_nvm_C_S_START;
define exported symbol CYMEM_CM33_0_S_m33ns_nvm_START = 0x22043800;
define exported symbol CYMEM_CM33_0_S_m33ns_nvm_C_START = 0x02043800;
define exported symbol CYMEM_CM33_0_S_m33ns_nvm_C_S_START = 0x12043800;
define exported symbol CYMEM_CM33_0_S_m33ns_nvm_S_START = 0x32043800;
define exported symbol CYMEM_CM33_0_S_m33ns_nvm_SIZE = 0x00008800;
define exported symbol CYMEM_CM33_0_S_m33ns_nvm_OFFSET = 0x00043800;
define exported symbol CYMEM_CM33_0_S_m33ns_nvm_sel_START = CYMEM_CM33_0_S_m33ns_nvm_C_START;
define exported symbol CYMEM_CM33_0_S_m33ns_nvm_sel_S_START = CYMEM_CM33_0_S_m33ns_nvm_C_S_START;
define exported symbol CYMEM_CM33_0_S_m33s_nvm_secondary_slot_START = 0x2204C000;
define exported symbol CYMEM_CM33_0_S_m33s_nvm_secondary_slot_C_START = 0x0204C000;
define exported symbol CYMEM_CM33_0_S_m33s_nvm_secondary_slot_C_S_START = 0x1204C000;
define exported symbol CYMEM_CM33_0_S_m33s_nvm_secondary_slot_S_START = 0x3204C000;
define exported symbol CYMEM_CM33_0_S_m33s_nvm_secondary_slot_SIZE = 0x0002B800;
define exported symbol CYMEM_CM33_0_S_m33s_nvm_secondary_slot_OFFSET = 0x0004C000;
define exported symbol CYMEM_CM33_0_S_m33s_nvm_secondary_slot_sel_START = CYMEM_CM33_0_S_m33s_nvm_secondary_slot_C_START;
define exported symbol CYMEM_CM33_0_S_m33s_nvm_secondary_slot_sel_S_START = CYMEM_CM33_0_S_m33s_nvm_secondary_slot_C_S_START;
define exported symbol CYMEM_CM33_0_S_m33_nvm_secondary_slot_START = 0x22077800;
define exported symbol CYMEM_CM33_0_S_m33_nvm_secondary_slot_C_START = 0x02077800;
define exported symbol CYMEM_CM33_0_S_m33_nvm_secondary_slot_C_S_START = 0x12077800;
define exported symbol CYMEM_CM33_0_S_m33_nvm_secondary_slot_S_START = 0x32077800;
define exported symbol CYMEM_CM33_0_S_m33_nvm_secondary_slot_SIZE = 0x00008800;
define exported symbol CYMEM_CM33_0_S_m33_nvm_secondary_slot_OFFSET = 0x00077800;
define exported symbol CYMEM_CM33_0_S_m33_nvm_secondary_slot_sel_START = CYMEM_CM33_0_S_m33_nvm_secondary_slot_C_START;
define exported symbol CYMEM_CM33_0_S_m33_nvm_secondary_slot_sel_S_START = CYMEM_CM33_0_S_m33_nvm_secondary_slot_C_S_START;
define exported symbol CYMEM_CM33_0_S_m33_shared_START = 0x24000000;
define exported symbol CYMEM_CM33_0_S_m33_shared_C_START = 0x04000000;
define exported symbol CYMEM_CM33_0_S_m33_shared_C_S_START = 0x14000000;
define exported symbol CYMEM_CM33_0_S_m33_shared_S_START = 0x34000000;
define exported symbol CYMEM_CM33_0_S_m33_shared_SIZE = 0x00001000;
define exported symbol CYMEM_CM33_0_S_m33_shared_OFFSET = 0x00000000;
define exported symbol CYMEM_CM33_0_S_m33_shared_sel_START = CYMEM_CM33_0_S_m33_shared_C_START;
define exported symbol CYMEM_CM33_0_S_m33_shared_sel_S_START = CYMEM_CM33_0_S_m33_shared_C_S_START;
define exported symbol CYMEM_CM33_0_S_m33_data_START = 0x24001000;
define exported symbol CYMEM_CM33_0_S_m33_data_C_START = 0x04001000;
define exported symbol CYMEM_CM33_0_S_m33_data_C_S_START = 0x14001000;
define exported symbol CYMEM_CM33_0_S_m33_data_S_START = 0x34001000;
define exported symbol CYMEM_CM33_0_S_m33_data_SIZE = 0x00017800;
define exported symbol CYMEM_CM33_0_S_m33_data_OFFSET = 0x00001000;
define exported symbol CYMEM_CM33_0_S_m33_data_sel_START = CYMEM_CM33_0_S_m33_data_C_START;
define exported symbol CYMEM_CM33_0_S_m33_data_sel_S_START = CYMEM_CM33_0_S_m33_data_C_S_START;
define exported symbol CYMEM_CM33_0_S_m33ns_data_START = 0x24018800;
define exported symbol CYMEM_CM33_0_S_m33ns_data_C_START = 0x04018800;
define exported symbol CYMEM_CM33_0_S_m33ns_data_C_S_START = 0x14018800;
define exported symbol CYMEM_CM33_0_S_m33ns_data_S_START = 0x34018800;
define exported symbol CYMEM_CM33_0_S_m33ns_data_SIZE = 0x00007000;
define exported symbol CYMEM_CM33_0_S_m33ns_data_OFFSET = 0x00018800;
define exported symbol CYMEM_CM33_0_S_m33ns_data_sel_START = CYMEM_CM33_0_S_m33ns_data_C_START;
define exported symbol CYMEM_CM33_0_S_m33ns_data_sel_S_START = CYMEM_CM33_0_S_m33ns_data_C_S_START;
define exported symbol CYMEM_CM33_0_S_m33ns_shm_data_START = 0x2401F800;
define exported symbol CYMEM_CM33_0_S_m33ns_shm_data_C_START = 0x0401F800;
define exported symbol CYMEM_CM33_0_S_m33ns_shm_data_C_S_START = 0x1401F800;
define exported symbol CYMEM_CM33_0_S_m33ns_shm_data_S_START = 0x3401F800;
define exported symbol CYMEM_CM33_0_S_m33ns_shm_data_SIZE = 0x00000800;
define exported symbol CYMEM_CM33_0_S_m33ns_shm_data_OFFSET = 0x0001F800;
define exported symbol CYMEM_CM33_0_S_m33ns_shm_data_sel_START = CYMEM_CM33_0_S_m33ns_shm_data_C_START;
define exported symbol CYMEM_CM33_0_S_m33ns_shm_data_sel_S_START = CYMEM_CM33_0_S_m33ns_shm_data_C_S_START;
