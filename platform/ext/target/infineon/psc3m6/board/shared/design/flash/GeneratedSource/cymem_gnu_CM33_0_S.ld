/* This file is automatically generated. */

CYMEM_CM33_0_S_TFM_NV_COUNTERS_START = 0x22014800;
CYMEM_CM33_0_S_TFM_NV_COUNTERS_C_START = 0x02014800;
CYMEM_CM33_0_S_TFM_NV_COUNTERS_C_S_START = 0x12014800;
CYMEM_CM33_0_S_TFM_NV_COUNTERS_S_START = 0x32014800;
CYMEM_CM33_0_S_TFM_NV_COUNTERS_SIZE = 0x00000800;
CYMEM_CM33_0_S_TFM_NV_COUNTERS_OFFSET = 0x00014800;
CYMEM_CM33_0_S_TFM_ITS_START = 0x22015000;
CYMEM_CM33_0_S_TFM_ITS_C_START = 0x02015000;
CYMEM_CM33_0_S_TFM_ITS_C_S_START = 0x12015000;
CYMEM_CM33_0_S_TFM_ITS_S_START = 0x32015000;
CYMEM_CM33_0_S_TFM_ITS_SIZE = 0x00001000;
CYMEM_CM33_0_S_TFM_ITS_OFFSET = 0x00015000;
CYMEM_CM33_0_S_TFM_PS_START = 0x22016000;
CYMEM_CM33_0_S_TFM_PS_C_START = 0x02016000;
CYMEM_CM33_0_S_TFM_PS_C_S_START = 0x12016000;
CYMEM_CM33_0_S_TFM_PS_S_START = 0x32016000;
CYMEM_CM33_0_S_TFM_PS_SIZE = 0x00002000;
CYMEM_CM33_0_S_TFM_PS_OFFSET = 0x00016000;
CYMEM_CM33_0_S_m33_nvm_START = 0x22018000;
CYMEM_CM33_0_S_m33_nvm_C_START = 0x02018000;
CYMEM_CM33_0_S_m33_nvm_C_S_START = 0x12018000;
CYMEM_CM33_0_S_m33_nvm_S_START = 0x32018000;
CYMEM_CM33_0_S_m33_nvm_SIZE = 0x0002B800;
CYMEM_CM33_0_S_m33_nvm_OFFSET = 0x00018000;
CYMEM_CM33_0_S_m33ns_nvm_START = 0x22043800;
CYMEM_CM33_0_S_m33ns_nvm_C_START = 0x02043800;
CYMEM_CM33_0_S_m33ns_nvm_C_S_START = 0x12043800;
CYMEM_CM33_0_S_m33ns_nvm_S_START = 0x32043800;
CYMEM_CM33_0_S_m33ns_nvm_SIZE = 0x00008800;
CYMEM_CM33_0_S_m33ns_nvm_OFFSET = 0x00043800;
CYMEM_CM33_0_S_m33s_nvm_secondary_slot_START = 0x2204C000;
CYMEM_CM33_0_S_m33s_nvm_secondary_slot_C_START = 0x0204C000;
CYMEM_CM33_0_S_m33s_nvm_secondary_slot_C_S_START = 0x1204C000;
CYMEM_CM33_0_S_m33s_nvm_secondary_slot_S_START = 0x3204C000;
CYMEM_CM33_0_S_m33s_nvm_secondary_slot_SIZE = 0x0002B800;
CYMEM_CM33_0_S_m33s_nvm_secondary_slot_OFFSET = 0x0004C000;
CYMEM_CM33_0_S_m33_nvm_secondary_slot_START = 0x22077800;
CYMEM_CM33_0_S_m33_nvm_secondary_slot_C_START = 0x02077800;
CYMEM_CM33_0_S_m33_nvm_secondary_slot_C_S_START = 0x12077800;
CYMEM_CM33_0_S_m33_nvm_secondary_slot_S_START = 0x32077800;
CYMEM_CM33_0_S_m33_nvm_secondary_slot_SIZE = 0x00008800;
CYMEM_CM33_0_S_m33_nvm_secondary_slot_OFFSET = 0x00077800;
CYMEM_CM33_0_S_m33_shared_START = 0x24000000;
CYMEM_CM33_0_S_m33_shared_C_START = 0x04000000;
CYMEM_CM33_0_S_m33_shared_C_S_START = 0x14000000;
CYMEM_CM33_0_S_m33_shared_S_START = 0x34000000;
CYMEM_CM33_0_S_m33_shared_SIZE = 0x00001000;
CYMEM_CM33_0_S_m33_shared_OFFSET = 0x00000000;
CYMEM_CM33_0_S_m33_data_START = 0x24001000;
CYMEM_CM33_0_S_m33_data_C_START = 0x04001000;
CYMEM_CM33_0_S_m33_data_C_S_START = 0x14001000;
CYMEM_CM33_0_S_m33_data_S_START = 0x34001000;
CYMEM_CM33_0_S_m33_data_SIZE = 0x00017800;
CYMEM_CM33_0_S_m33_data_OFFSET = 0x00001000;
CYMEM_CM33_0_S_m33ns_data_START = 0x24018800;
CYMEM_CM33_0_S_m33ns_data_C_START = 0x04018800;
CYMEM_CM33_0_S_m33ns_data_C_S_START = 0x14018800;
CYMEM_CM33_0_S_m33ns_data_S_START = 0x34018800;
CYMEM_CM33_0_S_m33ns_data_SIZE = 0x00007000;
CYMEM_CM33_0_S_m33ns_data_OFFSET = 0x00018800;
CYMEM_CM33_0_S_m33ns_shm_data_START = 0x2401F800;
CYMEM_CM33_0_S_m33ns_shm_data_C_START = 0x0401F800;
CYMEM_CM33_0_S_m33ns_shm_data_C_S_START = 0x1401F800;
CYMEM_CM33_0_S_m33ns_shm_data_S_START = 0x3401F800;
CYMEM_CM33_0_S_m33ns_shm_data_SIZE = 0x00000800;
CYMEM_CM33_0_S_m33ns_shm_data_OFFSET = 0x0001F800;

MEMORY
{
    TFM_NV_COUNTERS : ORIGIN = 0x22014800, LENGTH = 0x00000800
    TFM_NV_COUNTERS_C : ORIGIN = 0x02014800, LENGTH = 0x00000800
    TFM_NV_COUNTERS_C_S : ORIGIN = 0x12014800, LENGTH = 0x00000800
    TFM_NV_COUNTERS_S : ORIGIN = 0x32014800, LENGTH = 0x00000800
    TFM_ITS : ORIGIN = 0x22015000, LENGTH = 0x00001000
    TFM_ITS_C : ORIGIN = 0x02015000, LENGTH = 0x00001000
    TFM_ITS_C_S : ORIGIN = 0x12015000, LENGTH = 0x00001000
    TFM_ITS_S : ORIGIN = 0x32015000, LENGTH = 0x00001000
    TFM_PS : ORIGIN = 0x22016000, LENGTH = 0x00002000
    TFM_PS_C : ORIGIN = 0x02016000, LENGTH = 0x00002000
    TFM_PS_C_S : ORIGIN = 0x12016000, LENGTH = 0x00002000
    TFM_PS_S : ORIGIN = 0x32016000, LENGTH = 0x00002000
    m33_nvm : ORIGIN = 0x22018000, LENGTH = 0x0002B800
    m33_nvm_C : ORIGIN = 0x02018000, LENGTH = 0x0002B800
    m33_nvm_C_S : ORIGIN = 0x12018000, LENGTH = 0x0002B800
    m33_nvm_S : ORIGIN = 0x32018000, LENGTH = 0x0002B800
    m33ns_nvm : ORIGIN = 0x22043800, LENGTH = 0x00008800
    m33ns_nvm_C : ORIGIN = 0x02043800, LENGTH = 0x00008800
    m33ns_nvm_C_S : ORIGIN = 0x12043800, LENGTH = 0x00008800
    m33ns_nvm_S : ORIGIN = 0x32043800, LENGTH = 0x00008800
    m33s_nvm_secondary_slot : ORIGIN = 0x2204C000, LENGTH = 0x0002B800
    m33s_nvm_secondary_slot_C : ORIGIN = 0x0204C000, LENGTH = 0x0002B800
    m33s_nvm_secondary_slot_C_S : ORIGIN = 0x1204C000, LENGTH = 0x0002B800
    m33s_nvm_secondary_slot_S : ORIGIN = 0x3204C000, LENGTH = 0x0002B800
    m33_nvm_secondary_slot : ORIGIN = 0x22077800, LENGTH = 0x00008800
    m33_nvm_secondary_slot_C : ORIGIN = 0x02077800, LENGTH = 0x00008800
    m33_nvm_secondary_slot_C_S : ORIGIN = 0x12077800, LENGTH = 0x00008800
    m33_nvm_secondary_slot_S : ORIGIN = 0x32077800, LENGTH = 0x00008800
    m33_shared : ORIGIN = 0x24000000, LENGTH = 0x00001000
    m33_shared_C : ORIGIN = 0x04000000, LENGTH = 0x00001000
    m33_shared_C_S : ORIGIN = 0x14000000, LENGTH = 0x00001000
    m33_shared_S : ORIGIN = 0x34000000, LENGTH = 0x00001000
    m33_data : ORIGIN = 0x24001000, LENGTH = 0x00017800
    m33_data_C : ORIGIN = 0x04001000, LENGTH = 0x00017800
    m33_data_C_S : ORIGIN = 0x14001000, LENGTH = 0x00017800
    m33_data_S : ORIGIN = 0x34001000, LENGTH = 0x00017800
    m33ns_data : ORIGIN = 0x24018800, LENGTH = 0x00007000
    m33ns_data_C : ORIGIN = 0x04018800, LENGTH = 0x00007000
    m33ns_data_C_S : ORIGIN = 0x14018800, LENGTH = 0x00007000
    m33ns_data_S : ORIGIN = 0x34018800, LENGTH = 0x00007000
    m33ns_shm_data : ORIGIN = 0x2401F800, LENGTH = 0x00000800
    m33ns_shm_data_C : ORIGIN = 0x0401F800, LENGTH = 0x00000800
    m33ns_shm_data_C_S : ORIGIN = 0x1401F800, LENGTH = 0x00000800
    m33ns_shm_data_S : ORIGIN = 0x3401F800, LENGTH = 0x00000800
}

REGION_ALIAS("TFM_NV_COUNTERS_sel", TFM_NV_COUNTERS_C)
REGION_ALIAS("TFM_NV_COUNTERS_sel_S", TFM_NV_COUNTERS_C_S)
REGION_ALIAS("TFM_ITS_sel", TFM_ITS_C)
REGION_ALIAS("TFM_ITS_sel_S", TFM_ITS_C_S)
REGION_ALIAS("TFM_PS_sel", TFM_PS_C)
REGION_ALIAS("TFM_PS_sel_S", TFM_PS_C_S)
REGION_ALIAS("m33_nvm_sel", m33_nvm_C)
REGION_ALIAS("m33_nvm_sel_S", m33_nvm_C_S)
REGION_ALIAS("m33ns_nvm_sel", m33ns_nvm_C)
REGION_ALIAS("m33ns_nvm_sel_S", m33ns_nvm_C_S)
REGION_ALIAS("m33s_nvm_secondary_slot_sel", m33s_nvm_secondary_slot_C)
REGION_ALIAS("m33s_nvm_secondary_slot_sel_S", m33s_nvm_secondary_slot_C_S)
REGION_ALIAS("m33_nvm_secondary_slot_sel", m33_nvm_secondary_slot_C)
REGION_ALIAS("m33_nvm_secondary_slot_sel_S", m33_nvm_secondary_slot_C_S)
REGION_ALIAS("m33_shared_sel", m33_shared_C)
REGION_ALIAS("m33_shared_sel_S", m33_shared_C_S)
REGION_ALIAS("m33_data_sel", m33_data_C)
REGION_ALIAS("m33_data_sel_S", m33_data_C_S)
REGION_ALIAS("m33ns_data_sel", m33ns_data_C)
REGION_ALIAS("m33ns_data_sel_S", m33ns_data_C_S)
REGION_ALIAS("m33ns_shm_data_sel", m33ns_shm_data_C)
REGION_ALIAS("m33ns_shm_data_sel_S", m33ns_shm_data_C_S)
