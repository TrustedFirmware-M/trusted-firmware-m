// This file is automatically generated.
// define memory with size = 4G;
define region m55_data = [from CYMEM_CM33_0_S_m55_data_START size CYMEM_CM33_0_S_m55_data_SIZE];
define region m55_data_S = [from CYMEM_CM33_0_S_m55_data_S_START size CYMEM_CM33_0_S_m55_data_SIZE];
define region m55_data_sel = [from CYMEM_CM33_0_S_m55_data_START size CYMEM_CM33_0_S_m55_data_SIZE];
define region m55_data_sel_S = [from CYMEM_CM33_0_S_m55_data_S_START size CYMEM_CM33_0_S_m55_data_SIZE];
define region m55_code = [from CYMEM_CM33_0_S_m55_code_START size CYMEM_CM33_0_S_m55_code_SIZE];
define region m55_code_S = [from CYMEM_CM33_0_S_m55_code_S_START size CYMEM_CM33_0_S_m55_code_SIZE];
define region m55_code_sel = [from CYMEM_CM33_0_S_m55_code_START size CYMEM_CM33_0_S_m55_code_SIZE];
define region m55_code_sel_S = [from CYMEM_CM33_0_S_m55_code_S_START size CYMEM_CM33_0_S_m55_code_SIZE];
define region TFM_ITS = [from CYMEM_CM33_0_S_TFM_ITS_START size CYMEM_CM33_0_S_TFM_ITS_SIZE];
define region TFM_ITS_C = [from CYMEM_CM33_0_S_TFM_ITS_C_START size CYMEM_CM33_0_S_TFM_ITS_SIZE];
define region TFM_ITS_C_S = [from CYMEM_CM33_0_S_TFM_ITS_C_S_START size CYMEM_CM33_0_S_TFM_ITS_SIZE];
define region TFM_ITS_S = [from CYMEM_CM33_0_S_TFM_ITS_S_START size CYMEM_CM33_0_S_TFM_ITS_SIZE];
define region TFM_ITS_sel = [from CYMEM_CM33_0_S_TFM_ITS_C_START size CYMEM_CM33_0_S_TFM_ITS_SIZE];
define region TFM_ITS_sel_S = [from CYMEM_CM33_0_S_TFM_ITS_C_S_START size CYMEM_CM33_0_S_TFM_ITS_SIZE];
define region TFM_PS = [from CYMEM_CM33_0_S_TFM_PS_START size CYMEM_CM33_0_S_TFM_PS_SIZE];
define region TFM_PS_C = [from CYMEM_CM33_0_S_TFM_PS_C_START size CYMEM_CM33_0_S_TFM_PS_SIZE];
define region TFM_PS_C_S = [from CYMEM_CM33_0_S_TFM_PS_C_S_START size CYMEM_CM33_0_S_TFM_PS_SIZE];
define region TFM_PS_S = [from CYMEM_CM33_0_S_TFM_PS_S_START size CYMEM_CM33_0_S_TFM_PS_SIZE];
define region TFM_PS_sel = [from CYMEM_CM33_0_S_TFM_PS_C_START size CYMEM_CM33_0_S_TFM_PS_SIZE];
define region TFM_PS_sel_S = [from CYMEM_CM33_0_S_TFM_PS_C_S_START size CYMEM_CM33_0_S_TFM_PS_SIZE];
define region TFM_NV_COUNTERS = [from CYMEM_CM33_0_S_TFM_NV_COUNTERS_START size CYMEM_CM33_0_S_TFM_NV_COUNTERS_SIZE];
define region TFM_NV_COUNTERS_C = [from CYMEM_CM33_0_S_TFM_NV_COUNTERS_C_START size CYMEM_CM33_0_S_TFM_NV_COUNTERS_SIZE];
define region TFM_NV_COUNTERS_C_S = [from CYMEM_CM33_0_S_TFM_NV_COUNTERS_C_S_START size CYMEM_CM33_0_S_TFM_NV_COUNTERS_SIZE];
define region TFM_NV_COUNTERS_S = [from CYMEM_CM33_0_S_TFM_NV_COUNTERS_S_START size CYMEM_CM33_0_S_TFM_NV_COUNTERS_SIZE];
define region TFM_NV_COUNTERS_sel = [from CYMEM_CM33_0_S_TFM_NV_COUNTERS_C_START size CYMEM_CM33_0_S_TFM_NV_COUNTERS_SIZE];
define region TFM_NV_COUNTERS_sel_S = [from CYMEM_CM33_0_S_TFM_NV_COUNTERS_C_S_START size CYMEM_CM33_0_S_TFM_NV_COUNTERS_SIZE];
define region m33s_nvm = [from CYMEM_CM33_0_S_m33s_nvm_START size CYMEM_CM33_0_S_m33s_nvm_SIZE];
define region m33s_nvm_C = [from CYMEM_CM33_0_S_m33s_nvm_C_START size CYMEM_CM33_0_S_m33s_nvm_SIZE];
define region m33s_nvm_C_S = [from CYMEM_CM33_0_S_m33s_nvm_C_S_START size CYMEM_CM33_0_S_m33s_nvm_SIZE];
define region m33s_nvm_S = [from CYMEM_CM33_0_S_m33s_nvm_S_START size CYMEM_CM33_0_S_m33s_nvm_SIZE];
define region m33s_nvm_sel = [from CYMEM_CM33_0_S_m33s_nvm_C_START size CYMEM_CM33_0_S_m33s_nvm_SIZE];
define region m33s_nvm_sel_S = [from CYMEM_CM33_0_S_m33s_nvm_C_S_START size CYMEM_CM33_0_S_m33s_nvm_SIZE];
define region m33s_trailer = [from CYMEM_CM33_0_S_m33s_trailer_START size CYMEM_CM33_0_S_m33s_trailer_SIZE];
define region m33s_trailer_C = [from CYMEM_CM33_0_S_m33s_trailer_C_START size CYMEM_CM33_0_S_m33s_trailer_SIZE];
define region m33s_trailer_C_S = [from CYMEM_CM33_0_S_m33s_trailer_C_S_START size CYMEM_CM33_0_S_m33s_trailer_SIZE];
define region m33s_trailer_S = [from CYMEM_CM33_0_S_m33s_trailer_S_START size CYMEM_CM33_0_S_m33s_trailer_SIZE];
define region m33s_trailer_sel = [from CYMEM_CM33_0_S_m33s_trailer_C_START size CYMEM_CM33_0_S_m33s_trailer_SIZE];
define region m33s_trailer_sel_S = [from CYMEM_CM33_0_S_m33s_trailer_C_S_START size CYMEM_CM33_0_S_m33s_trailer_SIZE];
define region m33_nvm = [from CYMEM_CM33_0_S_m33_nvm_START size CYMEM_CM33_0_S_m33_nvm_SIZE];
define region m33_nvm_C = [from CYMEM_CM33_0_S_m33_nvm_C_START size CYMEM_CM33_0_S_m33_nvm_SIZE];
define region m33_nvm_C_S = [from CYMEM_CM33_0_S_m33_nvm_C_S_START size CYMEM_CM33_0_S_m33_nvm_SIZE];
define region m33_nvm_S = [from CYMEM_CM33_0_S_m33_nvm_S_START size CYMEM_CM33_0_S_m33_nvm_SIZE];
define region m33_nvm_sel = [from CYMEM_CM33_0_S_m33_nvm_C_START size CYMEM_CM33_0_S_m33_nvm_SIZE];
define region m33_nvm_sel_S = [from CYMEM_CM33_0_S_m33_nvm_C_S_START size CYMEM_CM33_0_S_m33_nvm_SIZE];
define region m33_trailer = [from CYMEM_CM33_0_S_m33_trailer_START size CYMEM_CM33_0_S_m33_trailer_SIZE];
define region m33_trailer_C = [from CYMEM_CM33_0_S_m33_trailer_C_START size CYMEM_CM33_0_S_m33_trailer_SIZE];
define region m33_trailer_C_S = [from CYMEM_CM33_0_S_m33_trailer_C_S_START size CYMEM_CM33_0_S_m33_trailer_SIZE];
define region m33_trailer_S = [from CYMEM_CM33_0_S_m33_trailer_S_START size CYMEM_CM33_0_S_m33_trailer_SIZE];
define region m33_trailer_sel = [from CYMEM_CM33_0_S_m33_trailer_C_START size CYMEM_CM33_0_S_m33_trailer_SIZE];
define region m33_trailer_sel_S = [from CYMEM_CM33_0_S_m33_trailer_C_S_START size CYMEM_CM33_0_S_m33_trailer_SIZE];
define region m55_nvm = [from CYMEM_CM33_0_S_m55_nvm_START size CYMEM_CM33_0_S_m55_nvm_SIZE];
define region m55_nvm_C = [from CYMEM_CM33_0_S_m55_nvm_C_START size CYMEM_CM33_0_S_m55_nvm_SIZE];
define region m55_nvm_C_S = [from CYMEM_CM33_0_S_m55_nvm_C_S_START size CYMEM_CM33_0_S_m55_nvm_SIZE];
define region m55_nvm_S = [from CYMEM_CM33_0_S_m55_nvm_S_START size CYMEM_CM33_0_S_m55_nvm_SIZE];
define region m55_nvm_sel = [from CYMEM_CM33_0_S_m55_nvm_C_START size CYMEM_CM33_0_S_m55_nvm_SIZE];
define region m55_nvm_sel_S = [from CYMEM_CM33_0_S_m55_nvm_C_S_START size CYMEM_CM33_0_S_m55_nvm_SIZE];
define region m55_trailer = [from CYMEM_CM33_0_S_m55_trailer_START size CYMEM_CM33_0_S_m55_trailer_SIZE];
define region m55_trailer_C = [from CYMEM_CM33_0_S_m55_trailer_C_START size CYMEM_CM33_0_S_m55_trailer_SIZE];
define region m55_trailer_C_S = [from CYMEM_CM33_0_S_m55_trailer_C_S_START size CYMEM_CM33_0_S_m55_trailer_SIZE];
define region m55_trailer_S = [from CYMEM_CM33_0_S_m55_trailer_S_START size CYMEM_CM33_0_S_m55_trailer_SIZE];
define region m55_trailer_sel = [from CYMEM_CM33_0_S_m55_trailer_C_START size CYMEM_CM33_0_S_m55_trailer_SIZE];
define region m55_trailer_sel_S = [from CYMEM_CM33_0_S_m55_trailer_C_S_START size CYMEM_CM33_0_S_m55_trailer_SIZE];
define region m55_code_secondary = [from CYMEM_CM33_0_S_m55_code_secondary_START size CYMEM_CM33_0_S_m55_code_secondary_SIZE];
define region m55_code_secondary_C = [from CYMEM_CM33_0_S_m55_code_secondary_C_START size CYMEM_CM33_0_S_m55_code_secondary_SIZE];
define region m55_code_secondary_C_S = [from CYMEM_CM33_0_S_m55_code_secondary_C_S_START size CYMEM_CM33_0_S_m55_code_secondary_SIZE];
define region m55_code_secondary_S = [from CYMEM_CM33_0_S_m55_code_secondary_S_START size CYMEM_CM33_0_S_m55_code_secondary_SIZE];
define region m55_code_secondary_sel = [from CYMEM_CM33_0_S_m55_code_secondary_C_START size CYMEM_CM33_0_S_m55_code_secondary_SIZE];
define region m55_code_secondary_sel_S = [from CYMEM_CM33_0_S_m55_code_secondary_C_S_START size CYMEM_CM33_0_S_m55_code_secondary_SIZE];
define region m55_data_secondary = [from CYMEM_CM33_0_S_m55_data_secondary_START size CYMEM_CM33_0_S_m55_data_secondary_SIZE];
define region m55_data_secondary_C = [from CYMEM_CM33_0_S_m55_data_secondary_C_START size CYMEM_CM33_0_S_m55_data_secondary_SIZE];
define region m55_data_secondary_C_S = [from CYMEM_CM33_0_S_m55_data_secondary_C_S_START size CYMEM_CM33_0_S_m55_data_secondary_SIZE];
define region m55_data_secondary_S = [from CYMEM_CM33_0_S_m55_data_secondary_S_START size CYMEM_CM33_0_S_m55_data_secondary_SIZE];
define region m55_data_secondary_sel = [from CYMEM_CM33_0_S_m55_data_secondary_C_START size CYMEM_CM33_0_S_m55_data_secondary_SIZE];
define region m55_data_secondary_sel_S = [from CYMEM_CM33_0_S_m55_data_secondary_C_S_START size CYMEM_CM33_0_S_m55_data_secondary_SIZE];
define region m33_m55_shared = [from CYMEM_CM33_0_S_m33_m55_shared_START size CYMEM_CM33_0_S_m33_m55_shared_SIZE];
define region m33_m55_shared_C = [from CYMEM_CM33_0_S_m33_m55_shared_C_START size CYMEM_CM33_0_S_m33_m55_shared_SIZE];
define region m33_m55_shared_C_S = [from CYMEM_CM33_0_S_m33_m55_shared_C_S_START size CYMEM_CM33_0_S_m33_m55_shared_SIZE];
define region m33_m55_shared_S = [from CYMEM_CM33_0_S_m33_m55_shared_S_START size CYMEM_CM33_0_S_m33_m55_shared_SIZE];
define region m33_m55_shared_sel = [from CYMEM_CM33_0_S_m33_m55_shared_C_START size CYMEM_CM33_0_S_m33_m55_shared_SIZE];
define region m33_m55_shared_sel_S = [from CYMEM_CM33_0_S_m33_m55_shared_C_S_START size CYMEM_CM33_0_S_m33_m55_shared_SIZE];
define region gfx_mem = [from CYMEM_CM33_0_S_gfx_mem_START size CYMEM_CM33_0_S_gfx_mem_SIZE];
define region gfx_mem_C = [from CYMEM_CM33_0_S_gfx_mem_C_START size CYMEM_CM33_0_S_gfx_mem_SIZE];
define region gfx_mem_C_S = [from CYMEM_CM33_0_S_gfx_mem_C_S_START size CYMEM_CM33_0_S_gfx_mem_SIZE];
define region gfx_mem_S = [from CYMEM_CM33_0_S_gfx_mem_S_START size CYMEM_CM33_0_S_gfx_mem_SIZE];
define region gfx_mem_sel = [from CYMEM_CM33_0_S_gfx_mem_C_START size CYMEM_CM33_0_S_gfx_mem_SIZE];
define region gfx_mem_sel_S = [from CYMEM_CM33_0_S_gfx_mem_C_S_START size CYMEM_CM33_0_S_gfx_mem_SIZE];
define region m33s_shared = [from CYMEM_CM33_0_S_m33s_shared_START size CYMEM_CM33_0_S_m33s_shared_SIZE];
define region m33s_shared_C = [from CYMEM_CM33_0_S_m33s_shared_C_START size CYMEM_CM33_0_S_m33s_shared_SIZE];
define region m33s_shared_C_S = [from CYMEM_CM33_0_S_m33s_shared_C_S_START size CYMEM_CM33_0_S_m33s_shared_SIZE];
define region m33s_shared_S = [from CYMEM_CM33_0_S_m33s_shared_S_START size CYMEM_CM33_0_S_m33s_shared_SIZE];
define region m33s_shared_sel = [from CYMEM_CM33_0_S_m33s_shared_C_START size CYMEM_CM33_0_S_m33s_shared_SIZE];
define region m33s_shared_sel_S = [from CYMEM_CM33_0_S_m33s_shared_C_S_START size CYMEM_CM33_0_S_m33s_shared_SIZE];
define region m33s_data = [from CYMEM_CM33_0_S_m33s_data_START size CYMEM_CM33_0_S_m33s_data_SIZE];
define region m33s_data_C = [from CYMEM_CM33_0_S_m33s_data_C_START size CYMEM_CM33_0_S_m33s_data_SIZE];
define region m33s_data_C_S = [from CYMEM_CM33_0_S_m33s_data_C_S_START size CYMEM_CM33_0_S_m33s_data_SIZE];
define region m33s_data_S = [from CYMEM_CM33_0_S_m33s_data_S_START size CYMEM_CM33_0_S_m33s_data_SIZE];
define region m33s_data_sel = [from CYMEM_CM33_0_S_m33s_data_C_START size CYMEM_CM33_0_S_m33s_data_SIZE];
define region m33s_data_sel_S = [from CYMEM_CM33_0_S_m33s_data_C_S_START size CYMEM_CM33_0_S_m33s_data_SIZE];
define region SRAM_REGION = [from CYMEM_CM33_0_S_SRAM_REGION_START size CYMEM_CM33_0_S_SRAM_REGION_SIZE];
define region SRAM_REGION_C = [from CYMEM_CM33_0_S_SRAM_REGION_C_START size CYMEM_CM33_0_S_SRAM_REGION_SIZE];
define region SRAM_REGION_C_S = [from CYMEM_CM33_0_S_SRAM_REGION_C_S_START size CYMEM_CM33_0_S_SRAM_REGION_SIZE];
define region SRAM_REGION_S = [from CYMEM_CM33_0_S_SRAM_REGION_S_START size CYMEM_CM33_0_S_SRAM_REGION_SIZE];
define region SRAM_REGION_sel = [from CYMEM_CM33_0_S_SRAM_REGION_C_START size CYMEM_CM33_0_S_SRAM_REGION_SIZE];
define region SRAM_REGION_sel_S = [from CYMEM_CM33_0_S_SRAM_REGION_C_S_START size CYMEM_CM33_0_S_SRAM_REGION_SIZE];
define region m33_code = [from CYMEM_CM33_0_S_m33_code_START size CYMEM_CM33_0_S_m33_code_SIZE];
define region m33_code_C = [from CYMEM_CM33_0_S_m33_code_C_START size CYMEM_CM33_0_S_m33_code_SIZE];
define region m33_code_C_S = [from CYMEM_CM33_0_S_m33_code_C_S_START size CYMEM_CM33_0_S_m33_code_SIZE];
define region m33_code_S = [from CYMEM_CM33_0_S_m33_code_S_START size CYMEM_CM33_0_S_m33_code_SIZE];
define region m33_code_sel = [from CYMEM_CM33_0_S_m33_code_C_START size CYMEM_CM33_0_S_m33_code_SIZE];
define region m33_code_sel_S = [from CYMEM_CM33_0_S_m33_code_C_S_START size CYMEM_CM33_0_S_m33_code_SIZE];
define region m33_data = [from CYMEM_CM33_0_S_m33_data_START size CYMEM_CM33_0_S_m33_data_SIZE];
define region m33_data_C = [from CYMEM_CM33_0_S_m33_data_C_START size CYMEM_CM33_0_S_m33_data_SIZE];
define region m33_data_C_S = [from CYMEM_CM33_0_S_m33_data_C_S_START size CYMEM_CM33_0_S_m33_data_SIZE];
define region m33_data_S = [from CYMEM_CM33_0_S_m33_data_S_START size CYMEM_CM33_0_S_m33_data_SIZE];
define region m33_data_sel = [from CYMEM_CM33_0_S_m33_data_C_START size CYMEM_CM33_0_S_m33_data_SIZE];
define region m33_data_sel_S = [from CYMEM_CM33_0_S_m33_data_C_S_START size CYMEM_CM33_0_S_m33_data_SIZE];
define region m33s_allocatable_shared = [from CYMEM_CM33_0_S_m33s_allocatable_shared_START size CYMEM_CM33_0_S_m33s_allocatable_shared_SIZE];
define region m33s_allocatable_shared_C = [from CYMEM_CM33_0_S_m33s_allocatable_shared_C_START size CYMEM_CM33_0_S_m33s_allocatable_shared_SIZE];
define region m33s_allocatable_shared_C_S = [from CYMEM_CM33_0_S_m33s_allocatable_shared_C_S_START size CYMEM_CM33_0_S_m33s_allocatable_shared_SIZE];
define region m33s_allocatable_shared_S = [from CYMEM_CM33_0_S_m33s_allocatable_shared_S_START size CYMEM_CM33_0_S_m33s_allocatable_shared_SIZE];
define region m33s_allocatable_shared_sel = [from CYMEM_CM33_0_S_m33s_allocatable_shared_C_START size CYMEM_CM33_0_S_m33s_allocatable_shared_SIZE];
define region m33s_allocatable_shared_sel_S = [from CYMEM_CM33_0_S_m33s_allocatable_shared_C_S_START size CYMEM_CM33_0_S_m33s_allocatable_shared_SIZE];
define region m33_allocatable_shared = [from CYMEM_CM33_0_S_m33_allocatable_shared_START size CYMEM_CM33_0_S_m33_allocatable_shared_SIZE];
define region m33_allocatable_shared_C = [from CYMEM_CM33_0_S_m33_allocatable_shared_C_START size CYMEM_CM33_0_S_m33_allocatable_shared_SIZE];
define region m33_allocatable_shared_C_S = [from CYMEM_CM33_0_S_m33_allocatable_shared_C_S_START size CYMEM_CM33_0_S_m33_allocatable_shared_SIZE];
define region m33_allocatable_shared_S = [from CYMEM_CM33_0_S_m33_allocatable_shared_S_START size CYMEM_CM33_0_S_m33_allocatable_shared_SIZE];
define region m33_allocatable_shared_sel = [from CYMEM_CM33_0_S_m33_allocatable_shared_C_START size CYMEM_CM33_0_S_m33_allocatable_shared_SIZE];
define region m33_allocatable_shared_sel_S = [from CYMEM_CM33_0_S_m33_allocatable_shared_C_S_START size CYMEM_CM33_0_S_m33_allocatable_shared_SIZE];
define region m55_allocatable_shared = [from CYMEM_CM33_0_S_m55_allocatable_shared_START size CYMEM_CM33_0_S_m55_allocatable_shared_SIZE];
define region m55_allocatable_shared_C = [from CYMEM_CM33_0_S_m55_allocatable_shared_C_START size CYMEM_CM33_0_S_m55_allocatable_shared_SIZE];
define region m55_allocatable_shared_C_S = [from CYMEM_CM33_0_S_m55_allocatable_shared_C_S_START size CYMEM_CM33_0_S_m55_allocatable_shared_SIZE];
define region m55_allocatable_shared_S = [from CYMEM_CM33_0_S_m55_allocatable_shared_S_START size CYMEM_CM33_0_S_m55_allocatable_shared_SIZE];
define region m55_allocatable_shared_sel = [from CYMEM_CM33_0_S_m55_allocatable_shared_C_START size CYMEM_CM33_0_S_m55_allocatable_shared_SIZE];
define region m55_allocatable_shared_sel_S = [from CYMEM_CM33_0_S_m55_allocatable_shared_C_S_START size CYMEM_CM33_0_S_m55_allocatable_shared_SIZE];
