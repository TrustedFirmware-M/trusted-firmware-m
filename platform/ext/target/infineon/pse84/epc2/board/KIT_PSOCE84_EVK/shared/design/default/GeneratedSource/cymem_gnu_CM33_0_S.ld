/* This file is automatically generated. */

CYMEM_CM33_0_S_m55_data_START = 0x48040000;
CYMEM_CM33_0_S_m55_data_S_START = 0x58040000;
CYMEM_CM33_0_S_m55_data_SIZE = 0x00040000;
CYMEM_CM33_0_S_m55_data_OFFSET = 0x00000000;
CYMEM_CM33_0_S_m55_code_START = 0x48000000;
CYMEM_CM33_0_S_m55_code_S_START = 0x58000000;
CYMEM_CM33_0_S_m55_code_SIZE = 0x00040000;
CYMEM_CM33_0_S_m55_code_OFFSET = 0x00000000;
CYMEM_CM33_0_S_TFM_ITS_START = 0x22035000;
CYMEM_CM33_0_S_TFM_ITS_C_START = 0x02035000;
CYMEM_CM33_0_S_TFM_ITS_C_S_START = 0x12035000;
CYMEM_CM33_0_S_TFM_ITS_S_START = 0x32035000;
CYMEM_CM33_0_S_TFM_ITS_SIZE = 0x00002000;
CYMEM_CM33_0_S_TFM_ITS_OFFSET = 0x00035000;
CYMEM_CM33_0_S_TFM_PS_START = 0x22037000;
CYMEM_CM33_0_S_TFM_PS_C_START = 0x02037000;
CYMEM_CM33_0_S_TFM_PS_C_S_START = 0x12037000;
CYMEM_CM33_0_S_TFM_PS_S_START = 0x32037000;
CYMEM_CM33_0_S_TFM_PS_SIZE = 0x00004000;
CYMEM_CM33_0_S_TFM_PS_OFFSET = 0x00037000;
CYMEM_CM33_0_S_TFM_NV_COUNTERS_START = 0x2203B000;
CYMEM_CM33_0_S_TFM_NV_COUNTERS_C_START = 0x0203B000;
CYMEM_CM33_0_S_TFM_NV_COUNTERS_C_S_START = 0x1203B000;
CYMEM_CM33_0_S_TFM_NV_COUNTERS_S_START = 0x3203B000;
CYMEM_CM33_0_S_TFM_NV_COUNTERS_SIZE = 0x00001000;
CYMEM_CM33_0_S_TFM_NV_COUNTERS_OFFSET = 0x0003B000;
CYMEM_CM33_0_S_m33s_nvm_START = 0x60100000;
CYMEM_CM33_0_S_m33s_nvm_C_START = 0x08100000;
CYMEM_CM33_0_S_m33s_nvm_C_S_START = 0x18100000;
CYMEM_CM33_0_S_m33s_nvm_S_START = 0x70100000;
CYMEM_CM33_0_S_m33s_nvm_SIZE = 0x00200000;
CYMEM_CM33_0_S_m33s_nvm_OFFSET = 0x00100000;
CYMEM_CM33_0_S_m33s_trailer_START = 0x60300000;
CYMEM_CM33_0_S_m33s_trailer_C_START = 0x08300000;
CYMEM_CM33_0_S_m33s_trailer_C_S_START = 0x18300000;
CYMEM_CM33_0_S_m33s_trailer_S_START = 0x70300000;
CYMEM_CM33_0_S_m33s_trailer_SIZE = 0x00040000;
CYMEM_CM33_0_S_m33s_trailer_OFFSET = 0x00300000;
CYMEM_CM33_0_S_m33_nvm_START = 0x60340000;
CYMEM_CM33_0_S_m33_nvm_C_START = 0x08340000;
CYMEM_CM33_0_S_m33_nvm_C_S_START = 0x18340000;
CYMEM_CM33_0_S_m33_nvm_S_START = 0x70340000;
CYMEM_CM33_0_S_m33_nvm_SIZE = 0x00200000;
CYMEM_CM33_0_S_m33_nvm_OFFSET = 0x00340000;
CYMEM_CM33_0_S_m33_trailer_START = 0x60540000;
CYMEM_CM33_0_S_m33_trailer_C_START = 0x08540000;
CYMEM_CM33_0_S_m33_trailer_C_S_START = 0x18540000;
CYMEM_CM33_0_S_m33_trailer_S_START = 0x70540000;
CYMEM_CM33_0_S_m33_trailer_SIZE = 0x00040000;
CYMEM_CM33_0_S_m33_trailer_OFFSET = 0x00540000;
CYMEM_CM33_0_S_m55_nvm_START = 0x60580000;
CYMEM_CM33_0_S_m55_nvm_C_START = 0x08580000;
CYMEM_CM33_0_S_m55_nvm_C_S_START = 0x18580000;
CYMEM_CM33_0_S_m55_nvm_S_START = 0x70580000;
CYMEM_CM33_0_S_m55_nvm_SIZE = 0x002C0000;
CYMEM_CM33_0_S_m55_nvm_OFFSET = 0x00580000;
CYMEM_CM33_0_S_m55_trailer_START = 0x60840000;
CYMEM_CM33_0_S_m55_trailer_C_START = 0x08840000;
CYMEM_CM33_0_S_m55_trailer_C_S_START = 0x18840000;
CYMEM_CM33_0_S_m55_trailer_S_START = 0x70840000;
CYMEM_CM33_0_S_m55_trailer_SIZE = 0x00040000;
CYMEM_CM33_0_S_m55_trailer_OFFSET = 0x00840000;
CYMEM_CM33_0_S_m55_code_secondary_START = 0x26000000;
CYMEM_CM33_0_S_m55_code_secondary_C_START = 0x06000000;
CYMEM_CM33_0_S_m55_code_secondary_C_S_START = 0x16000000;
CYMEM_CM33_0_S_m55_code_secondary_S_START = 0x36000000;
CYMEM_CM33_0_S_m55_code_secondary_SIZE = 0x00040000;
CYMEM_CM33_0_S_m55_code_secondary_OFFSET = 0x00000000;
CYMEM_CM33_0_S_m55_data_secondary_START = 0x26040000;
CYMEM_CM33_0_S_m55_data_secondary_C_START = 0x06040000;
CYMEM_CM33_0_S_m55_data_secondary_C_S_START = 0x16040000;
CYMEM_CM33_0_S_m55_data_secondary_S_START = 0x36040000;
CYMEM_CM33_0_S_m55_data_secondary_SIZE = 0x002BE000;
CYMEM_CM33_0_S_m55_data_secondary_OFFSET = 0x00040000;
CYMEM_CM33_0_S_m33_m55_shared_START = 0x262FE000;
CYMEM_CM33_0_S_m33_m55_shared_C_START = 0x062FE000;
CYMEM_CM33_0_S_m33_m55_shared_C_S_START = 0x162FE000;
CYMEM_CM33_0_S_m33_m55_shared_S_START = 0x362FE000;
CYMEM_CM33_0_S_m33_m55_shared_SIZE = 0x00040000;
CYMEM_CM33_0_S_m33_m55_shared_OFFSET = 0x002FE000;
CYMEM_CM33_0_S_gfx_mem_START = 0x2633E000;
CYMEM_CM33_0_S_gfx_mem_C_START = 0x0633E000;
CYMEM_CM33_0_S_gfx_mem_C_S_START = 0x1633E000;
CYMEM_CM33_0_S_gfx_mem_S_START = 0x3633E000;
CYMEM_CM33_0_S_gfx_mem_SIZE = 0x001C2000;
CYMEM_CM33_0_S_gfx_mem_OFFSET = 0x0033E000;
CYMEM_CM33_0_S_m33s_shared_START = 0x24001000;
CYMEM_CM33_0_S_m33s_shared_C_START = 0x04001000;
CYMEM_CM33_0_S_m33s_shared_C_S_START = 0x14001000;
CYMEM_CM33_0_S_m33s_shared_S_START = 0x34001000;
CYMEM_CM33_0_S_m33s_shared_SIZE = 0x00001000;
CYMEM_CM33_0_S_m33s_shared_OFFSET = 0x00001000;
CYMEM_CM33_0_S_m33s_data_START = 0x24002000;
CYMEM_CM33_0_S_m33s_data_C_START = 0x04002000;
CYMEM_CM33_0_S_m33s_data_C_S_START = 0x14002000;
CYMEM_CM33_0_S_m33s_data_S_START = 0x34002000;
CYMEM_CM33_0_S_m33s_data_SIZE = 0x00020000;
CYMEM_CM33_0_S_m33s_data_OFFSET = 0x00002000;
CYMEM_CM33_0_S_SRAM_REGION_START = 0x24022000;
CYMEM_CM33_0_S_SRAM_REGION_C_START = 0x04022000;
CYMEM_CM33_0_S_SRAM_REGION_C_S_START = 0x14022000;
CYMEM_CM33_0_S_SRAM_REGION_S_START = 0x34022000;
CYMEM_CM33_0_S_SRAM_REGION_SIZE = 0x00036000;
CYMEM_CM33_0_S_SRAM_REGION_OFFSET = 0x00022000;
CYMEM_CM33_0_S_m33_code_START = 0x24058000;
CYMEM_CM33_0_S_m33_code_C_START = 0x04058000;
CYMEM_CM33_0_S_m33_code_C_S_START = 0x14058000;
CYMEM_CM33_0_S_m33_code_S_START = 0x34058000;
CYMEM_CM33_0_S_m33_code_SIZE = 0x00065000;
CYMEM_CM33_0_S_m33_code_OFFSET = 0x00058000;
CYMEM_CM33_0_S_m33_data_START = 0x240BD000;
CYMEM_CM33_0_S_m33_data_C_START = 0x040BD000;
CYMEM_CM33_0_S_m33_data_C_S_START = 0x140BD000;
CYMEM_CM33_0_S_m33_data_S_START = 0x340BD000;
CYMEM_CM33_0_S_m33_data_SIZE = 0x00040000;
CYMEM_CM33_0_S_m33_data_OFFSET = 0x000BD000;
CYMEM_CM33_0_S_m33s_allocatable_shared_START = 0x240FD000;
CYMEM_CM33_0_S_m33s_allocatable_shared_C_START = 0x040FD000;
CYMEM_CM33_0_S_m33s_allocatable_shared_C_S_START = 0x140FD000;
CYMEM_CM33_0_S_m33s_allocatable_shared_S_START = 0x340FD000;
CYMEM_CM33_0_S_m33s_allocatable_shared_SIZE = 0x00001000;
CYMEM_CM33_0_S_m33s_allocatable_shared_OFFSET = 0x000FD000;
CYMEM_CM33_0_S_m33_allocatable_shared_START = 0x240FE000;
CYMEM_CM33_0_S_m33_allocatable_shared_C_START = 0x040FE000;
CYMEM_CM33_0_S_m33_allocatable_shared_C_S_START = 0x140FE000;
CYMEM_CM33_0_S_m33_allocatable_shared_S_START = 0x340FE000;
CYMEM_CM33_0_S_m33_allocatable_shared_SIZE = 0x00001000;
CYMEM_CM33_0_S_m33_allocatable_shared_OFFSET = 0x000FE000;
CYMEM_CM33_0_S_m55_allocatable_shared_START = 0x240FF000;
CYMEM_CM33_0_S_m55_allocatable_shared_C_START = 0x040FF000;
CYMEM_CM33_0_S_m55_allocatable_shared_C_S_START = 0x140FF000;
CYMEM_CM33_0_S_m55_allocatable_shared_S_START = 0x340FF000;
CYMEM_CM33_0_S_m55_allocatable_shared_SIZE = 0x00001000;
CYMEM_CM33_0_S_m55_allocatable_shared_OFFSET = 0x000FF000;

MEMORY
{
    m55_data : ORIGIN = 0x48040000, LENGTH = 0x00040000
    m55_data_S : ORIGIN = 0x58040000, LENGTH = 0x00040000
    m55_code : ORIGIN = 0x48000000, LENGTH = 0x00040000
    m55_code_S : ORIGIN = 0x58000000, LENGTH = 0x00040000
    TFM_ITS : ORIGIN = 0x22035000, LENGTH = 0x00002000
    TFM_ITS_C : ORIGIN = 0x02035000, LENGTH = 0x00002000
    TFM_ITS_C_S : ORIGIN = 0x12035000, LENGTH = 0x00002000
    TFM_ITS_S : ORIGIN = 0x32035000, LENGTH = 0x00002000
    TFM_PS : ORIGIN = 0x22037000, LENGTH = 0x00004000
    TFM_PS_C : ORIGIN = 0x02037000, LENGTH = 0x00004000
    TFM_PS_C_S : ORIGIN = 0x12037000, LENGTH = 0x00004000
    TFM_PS_S : ORIGIN = 0x32037000, LENGTH = 0x00004000
    TFM_NV_COUNTERS : ORIGIN = 0x2203B000, LENGTH = 0x00001000
    TFM_NV_COUNTERS_C : ORIGIN = 0x0203B000, LENGTH = 0x00001000
    TFM_NV_COUNTERS_C_S : ORIGIN = 0x1203B000, LENGTH = 0x00001000
    TFM_NV_COUNTERS_S : ORIGIN = 0x3203B000, LENGTH = 0x00001000
    m33s_nvm : ORIGIN = 0x60100000, LENGTH = 0x00200000
    m33s_nvm_C : ORIGIN = 0x08100000, LENGTH = 0x00200000
    m33s_nvm_C_S : ORIGIN = 0x18100000, LENGTH = 0x00200000
    m33s_nvm_S : ORIGIN = 0x70100000, LENGTH = 0x00200000
    m33s_trailer : ORIGIN = 0x60300000, LENGTH = 0x00040000
    m33s_trailer_C : ORIGIN = 0x08300000, LENGTH = 0x00040000
    m33s_trailer_C_S : ORIGIN = 0x18300000, LENGTH = 0x00040000
    m33s_trailer_S : ORIGIN = 0x70300000, LENGTH = 0x00040000
    m33_nvm : ORIGIN = 0x60340000, LENGTH = 0x00200000
    m33_nvm_C : ORIGIN = 0x08340000, LENGTH = 0x00200000
    m33_nvm_C_S : ORIGIN = 0x18340000, LENGTH = 0x00200000
    m33_nvm_S : ORIGIN = 0x70340000, LENGTH = 0x00200000
    m33_trailer : ORIGIN = 0x60540000, LENGTH = 0x00040000
    m33_trailer_C : ORIGIN = 0x08540000, LENGTH = 0x00040000
    m33_trailer_C_S : ORIGIN = 0x18540000, LENGTH = 0x00040000
    m33_trailer_S : ORIGIN = 0x70540000, LENGTH = 0x00040000
    m55_nvm : ORIGIN = 0x60580000, LENGTH = 0x002C0000
    m55_nvm_C : ORIGIN = 0x08580000, LENGTH = 0x002C0000
    m55_nvm_C_S : ORIGIN = 0x18580000, LENGTH = 0x002C0000
    m55_nvm_S : ORIGIN = 0x70580000, LENGTH = 0x002C0000
    m55_trailer : ORIGIN = 0x60840000, LENGTH = 0x00040000
    m55_trailer_C : ORIGIN = 0x08840000, LENGTH = 0x00040000
    m55_trailer_C_S : ORIGIN = 0x18840000, LENGTH = 0x00040000
    m55_trailer_S : ORIGIN = 0x70840000, LENGTH = 0x00040000
    m55_code_secondary : ORIGIN = 0x26000000, LENGTH = 0x00040000
    m55_code_secondary_C : ORIGIN = 0x06000000, LENGTH = 0x00040000
    m55_code_secondary_C_S : ORIGIN = 0x16000000, LENGTH = 0x00040000
    m55_code_secondary_S : ORIGIN = 0x36000000, LENGTH = 0x00040000
    m55_data_secondary : ORIGIN = 0x26040000, LENGTH = 0x002BE000
    m55_data_secondary_C : ORIGIN = 0x06040000, LENGTH = 0x002BE000
    m55_data_secondary_C_S : ORIGIN = 0x16040000, LENGTH = 0x002BE000
    m55_data_secondary_S : ORIGIN = 0x36040000, LENGTH = 0x002BE000
    m33_m55_shared : ORIGIN = 0x262FE000, LENGTH = 0x00040000
    m33_m55_shared_C : ORIGIN = 0x062FE000, LENGTH = 0x00040000
    m33_m55_shared_C_S : ORIGIN = 0x162FE000, LENGTH = 0x00040000
    m33_m55_shared_S : ORIGIN = 0x362FE000, LENGTH = 0x00040000
    gfx_mem : ORIGIN = 0x2633E000, LENGTH = 0x001C2000
    gfx_mem_C : ORIGIN = 0x0633E000, LENGTH = 0x001C2000
    gfx_mem_C_S : ORIGIN = 0x1633E000, LENGTH = 0x001C2000
    gfx_mem_S : ORIGIN = 0x3633E000, LENGTH = 0x001C2000
    m33s_shared : ORIGIN = 0x24001000, LENGTH = 0x00001000
    m33s_shared_C : ORIGIN = 0x04001000, LENGTH = 0x00001000
    m33s_shared_C_S : ORIGIN = 0x14001000, LENGTH = 0x00001000
    m33s_shared_S : ORIGIN = 0x34001000, LENGTH = 0x00001000
    m33s_data : ORIGIN = 0x24002000, LENGTH = 0x00020000
    m33s_data_C : ORIGIN = 0x04002000, LENGTH = 0x00020000
    m33s_data_C_S : ORIGIN = 0x14002000, LENGTH = 0x00020000
    m33s_data_S : ORIGIN = 0x34002000, LENGTH = 0x00020000
    SRAM_REGION : ORIGIN = 0x24022000, LENGTH = 0x00036000
    SRAM_REGION_C : ORIGIN = 0x04022000, LENGTH = 0x00036000
    SRAM_REGION_C_S : ORIGIN = 0x14022000, LENGTH = 0x00036000
    SRAM_REGION_S : ORIGIN = 0x34022000, LENGTH = 0x00036000
    m33_code : ORIGIN = 0x24058000, LENGTH = 0x00065000
    m33_code_C : ORIGIN = 0x04058000, LENGTH = 0x00065000
    m33_code_C_S : ORIGIN = 0x14058000, LENGTH = 0x00065000
    m33_code_S : ORIGIN = 0x34058000, LENGTH = 0x00065000
    m33_data : ORIGIN = 0x240BD000, LENGTH = 0x00040000
    m33_data_C : ORIGIN = 0x040BD000, LENGTH = 0x00040000
    m33_data_C_S : ORIGIN = 0x140BD000, LENGTH = 0x00040000
    m33_data_S : ORIGIN = 0x340BD000, LENGTH = 0x00040000
    m33s_allocatable_shared : ORIGIN = 0x240FD000, LENGTH = 0x00001000
    m33s_allocatable_shared_C : ORIGIN = 0x040FD000, LENGTH = 0x00001000
    m33s_allocatable_shared_C_S : ORIGIN = 0x140FD000, LENGTH = 0x00001000
    m33s_allocatable_shared_S : ORIGIN = 0x340FD000, LENGTH = 0x00001000
    m33_allocatable_shared : ORIGIN = 0x240FE000, LENGTH = 0x00001000
    m33_allocatable_shared_C : ORIGIN = 0x040FE000, LENGTH = 0x00001000
    m33_allocatable_shared_C_S : ORIGIN = 0x140FE000, LENGTH = 0x00001000
    m33_allocatable_shared_S : ORIGIN = 0x340FE000, LENGTH = 0x00001000
    m55_allocatable_shared : ORIGIN = 0x240FF000, LENGTH = 0x00001000
    m55_allocatable_shared_C : ORIGIN = 0x040FF000, LENGTH = 0x00001000
    m55_allocatable_shared_C_S : ORIGIN = 0x140FF000, LENGTH = 0x00001000
    m55_allocatable_shared_S : ORIGIN = 0x340FF000, LENGTH = 0x00001000
}

REGION_ALIAS("m55_data_sel", m55_data)
REGION_ALIAS("m55_data_sel_S", m55_data_S)
REGION_ALIAS("m55_code_sel", m55_code)
REGION_ALIAS("m55_code_sel_S", m55_code_S)
REGION_ALIAS("TFM_ITS_sel", TFM_ITS_C)
REGION_ALIAS("TFM_ITS_sel_S", TFM_ITS_C_S)
REGION_ALIAS("TFM_PS_sel", TFM_PS_C)
REGION_ALIAS("TFM_PS_sel_S", TFM_PS_C_S)
REGION_ALIAS("TFM_NV_COUNTERS_sel", TFM_NV_COUNTERS_C)
REGION_ALIAS("TFM_NV_COUNTERS_sel_S", TFM_NV_COUNTERS_C_S)
REGION_ALIAS("m33s_nvm_sel", m33s_nvm_C)
REGION_ALIAS("m33s_nvm_sel_S", m33s_nvm_C_S)
REGION_ALIAS("m33s_trailer_sel", m33s_trailer_C)
REGION_ALIAS("m33s_trailer_sel_S", m33s_trailer_C_S)
REGION_ALIAS("m33_nvm_sel", m33_nvm_C)
REGION_ALIAS("m33_nvm_sel_S", m33_nvm_C_S)
REGION_ALIAS("m33_trailer_sel", m33_trailer_C)
REGION_ALIAS("m33_trailer_sel_S", m33_trailer_C_S)
REGION_ALIAS("m55_nvm_sel", m55_nvm_C)
REGION_ALIAS("m55_nvm_sel_S", m55_nvm_C_S)
REGION_ALIAS("m55_trailer_sel", m55_trailer_C)
REGION_ALIAS("m55_trailer_sel_S", m55_trailer_C_S)
REGION_ALIAS("m55_code_secondary_sel", m55_code_secondary_C)
REGION_ALIAS("m55_code_secondary_sel_S", m55_code_secondary_C_S)
REGION_ALIAS("m55_data_secondary_sel", m55_data_secondary_C)
REGION_ALIAS("m55_data_secondary_sel_S", m55_data_secondary_C_S)
REGION_ALIAS("m33_m55_shared_sel", m33_m55_shared_C)
REGION_ALIAS("m33_m55_shared_sel_S", m33_m55_shared_C_S)
REGION_ALIAS("gfx_mem_sel", gfx_mem_C)
REGION_ALIAS("gfx_mem_sel_S", gfx_mem_C_S)
REGION_ALIAS("m33s_shared_sel", m33s_shared_C)
REGION_ALIAS("m33s_shared_sel_S", m33s_shared_C_S)
REGION_ALIAS("m33s_data_sel", m33s_data_C)
REGION_ALIAS("m33s_data_sel_S", m33s_data_C_S)
REGION_ALIAS("SRAM_REGION_sel", SRAM_REGION_C)
REGION_ALIAS("SRAM_REGION_sel_S", SRAM_REGION_C_S)
REGION_ALIAS("m33_code_sel", m33_code_C)
REGION_ALIAS("m33_code_sel_S", m33_code_C_S)
REGION_ALIAS("m33_data_sel", m33_data_C)
REGION_ALIAS("m33_data_sel_S", m33_data_C_S)
REGION_ALIAS("m33s_allocatable_shared_sel", m33s_allocatable_shared_C)
REGION_ALIAS("m33s_allocatable_shared_sel_S", m33s_allocatable_shared_C_S)
REGION_ALIAS("m33_allocatable_shared_sel", m33_allocatable_shared_C)
REGION_ALIAS("m33_allocatable_shared_sel_S", m33_allocatable_shared_C_S)
REGION_ALIAS("m55_allocatable_shared_sel", m55_allocatable_shared_C)
REGION_ALIAS("m55_allocatable_shared_sel_S", m55_allocatable_shared_C_S)
