## platform/ext/target/stm/common/devicetree/bindings/mtd/jedec,spi-nor.yaml
```yaml
# Copyright (c) 2023 STMICROELECTRONICS
# SPDX-License-Identifier: Apache-2.0

description: SPI NOR flash chips

compatible: "jedec,spi-nor"

properties:
  reg:
    type: int
    description: Chip select used by the device.
    required: true

  spi-max-frequency:
    type: int
    description: Maximum SPI clocking speed of the device in Hz.
    required: true

  spi-rx-bus-width:
    type: int
    description: Bus width to the SPI bus used for read transfers.
    enum:
      - 1 # SPI mode on 1 data line
      - 2 # Dual mode on 2 data lines
      - 4 # Quad mode on 4 data lines
      - 8 # Octo mode on 8 data lines

  spi-tx-bus-width:
    type: int
    description: Bus width to the SPI bus used for write transfers.
    enum:
      - 1 # SPI mode on 1 data line
      - 2 # Dual mode on 2 data lines
      - 4 # Quad mode on 4 data lines
      - 8 # Octo mode on 8 data lines

  size:
    type: int
    description: Size of the device in bytes.
    required: true

  erase-size:
    type: int
    description: Size of a block or sector of the device in bytes.
    required: true

  write-size:
    type: int
    description: Size of a write sector of the device in bytes.
    enum: [256, 512]
    required: true

  read-cmd:
    type: string
    description: The read command to used.
      If the property is not present, "READ" command is used.
    enum:
      - "READ"
      - "READ_FAST"
      - "READ_1_1_4"
      - "READ_1_1_4_4B"

  write-cmd:
    type: string
    description: The write command to used.
      If the property is not present, "WRITE" command is used.
    enum:
      - "WRITE"
      - "WRITE_1_4_4"
      - "WRITE_1_4_4_4B"

  erase-cmd:
    type: string
    description: The erase command to used.
      If the property is not present, "BE" command is used.
    enum:
      - "BE"
      - "BE_4B"
      - "SE"
      - "SE_4B"

  use-bank:
    type: boolean
    description: The flash supports the bank selection. It allows to
      address more than the first 16 Mbytes of the flash.

  use-fsr:
    type: boolean
    description: The flash supports the Flag status register that indicates
      various errors that may be encountered during erase/write operations.
```

## platform/ext/target/stm/common/devicetree/bindings/syscon/syscon.yaml
```yaml
# Copyright (c) 2023 STMICROELECTRONICS
# SPDX-License-Identifier: Apache-2.0

description: System Controller Registers R/W

compatible: "syscon"

include: [base.yaml]

properties:
  reg:
    required: true
```

## platform/ext/target/stm/common/devicetree/bindings/timer/arm,armv8m-systick.yaml
```yaml
# Copyright (c) 2023 STMICROELECTRONICS
# SPDX-License-Identifier: Apache-2.0

description: ARMv8-M System Tick

compatible: "arm,armv8m-systick"

include: base.yaml

properties:
  reg:
    required: true

  clock-frequency:
    type: int
    required: true
    description: Clock frequency information for Timer operation

  clocks:
    required: true
```

## secure_fw/partitions/Kconfig
```kconfig
#-------------------------------------------------------------------------------
# SPDX-FileCopyrightText: Copyright The TrustedFirmware-M Contributors
#
# SPDX-License-Identifier: BSD-3-Clause
#
#-------------------------------------------------------------------------------

menu "Secure partitions"

rsource "protected_storage/Kconfig"
rsource "initial_attestation/Kconfig"
rsource "firmware_update/Kconfig"
rsource "crypto/Kconfig"
rsource "platform/Kconfig"
rsource "internal_trusted_storage/Kconfig"

choice PARTITION_LOG_LEVEL
    prompt "Secure Partition Log Level"
    default LOG_LEVEL_NONE

    config LOG_LEVEL_VERBOSE
        bool "Verbose"

    config LOG_LEVEL_INFO
        bool "Info"

    config LOG_LEVEL_WARNING
        bool "Warning"

    config LOG_LEVEL_NOTICE
        bool "Notice"

    config LOG_LEVEL_ERROR
        bool "Error"

    config LOG_LEVEL_NONE
        bool "None"
endchoice

config TFM_PARTITION_LOG_LEVEL
    int
    default 50 if LOG_LEVEL_VERBOSE
    default 40 if LOG_LEVEL_INFO
    default 30 if LOG_LEVEL_WARN
    default 20 if LOG_LEVEL_NOTICE
    default 10 if LOG_LEVEL_ERROR
    default 0 if LOG_LEVEL_NONE

config TFM_SP_LOG_RAW_ENABLED
    bool
    default y if TFM_PARTITION_LOG_LEVEL != 0 || TFM_S_REG_TEST || TFM_NS_REG_TEST
    default n

endmenu
```
