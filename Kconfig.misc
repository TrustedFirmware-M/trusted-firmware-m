## Kconfig.misc
```kconfig
#-------------------------------------------------------------------------------
# SPDX-FileCopyrightText: Copyright The TrustedFirmware-M Contributors
#
# SPDX-License-Identifier: BSD-3-Clause
#
#-------------------------------------------------------------------------------

config TFM_CODE_SHARING
    bool "Enable code sharing between MCUboot and secure firmware"
    #FIXME: Shall check IAR
    default n
    depends on !CRYPTO_HW_ACCELERATOR
    help
      This feature is only officially tested on AN521 and Musca-B1 platforms.

################################# NS ###########################################

menu "NS support"
config NS
    bool "NS app"
    default y

config TFM_NS_MANAGE_NSID
    bool "Support NSPE OS providing NSPE client_id"
    depends on !TFM_MULTI_CORE_TOPOLOGY
    help
      An NSPE client_id is provided by the NSPE OS via the SPM or directly
      by the SPM. When `TFM_NS_MANAGE_NSID` is `ON`, TF-M supports NSPE OS
      providing NSPE client_id.

config NS_EVALUATION_APP_PATH
    string "Path to TFM NS Evaluation Application"
    default ""
endmenu

################################# TF-PSA-Crypto ################################

menu "TF-PSA-Crypto profile"

config TF_PSA_CRYPTO_BUILD_TYPE
    string "TF-PSA-Crypto build type"
    default "$(CMAKE_BUILD_TYPE)"

config TFM_TF_PSA_CRYPTO_CONFIG_PATH
    string "TF-PSA-Crypto config path"
    default "$(TFM_SOURCE_DIR)/lib/ext/tf-psa-crypto/tfpsacrypto_config/crypto_config_default.h"
    help
      Config to use for TF-PSA-Crypto. For increased flexibility when
      pointing to a file, set the type of this setting to 'STRING' by
      passing the :<type> portion when specifying the setting value in
      the command line. E.g.
      '-DTFM_TF_PSA_CRYPTO_CONFIG_PATH:STRING=some_file_which_is_generated.h'
      This can be useful if the config file is generated and placed
      inside a directory already added to the include path of TF-PSA-Crypto.

config TFM_TF_PSA_CRYPTO_PLATFORM_EXTRA_CONFIG_PATH
    string "TF-PSA-Crypto platform crypto config path"
    default ""
    help
      Config to append to standard TF-PSA-Crypto config, used by platforms
      to configure feature support

endmenu

################################# Manifest #####################################

config TFM_MANIFEST_LIST
    string "TF-M native Secure Partition manifests list file"
    default "$(TFM_SOURCE_DIR)/tools/tfm_manifest_list.yaml"
    help
      TF-M native Secure Partition manifests list file
```

## bl1/Kconfig
```kconfig
#-------------------------------------------------------------------------------
# SPDX-FileCopyrightText: Copyright The TrustedFirmware-M Contributors
#
# SPDX-License-Identifier: BSD-3-Clause
#
#-------------------------------------------------------------------------------

menuconfig BL1
    bool "BL1"
    default n

if BL1 && PLATFORM_DEFAULT_BL1

config TFM_BL2_ENCRYPTION_KEY_PATH
    string
    default "$(TFM_SOURCE_DIR)/bl1/bl1_2/bl2_dummy_encryption_key.bin"
    help
      Path to binary key to use for encrypting BL2

config TFM_GUK_PATH
    string
    default "$(TFM_SOURCE_DIR)/bl1/bl1_1/dummy_guk.bin"
    help
      Path to binary GUK key file to provision

config TFM_BL2_IMAGE_FLASH_AREA_NUM
    int "Which flash area BL2 is stored in"
    default 0

config TFM_GENERATE_BL1_2_CM_SIGNING_KEY
    bool "Generate new keypair or use TFM_BL2_CM_SIGNING_KEY_PATH for signing"
    default n

config TFM_GENERATE_BL1_2_DM_SIGNING_KEY
    bool "Generate new keypair or use TFM_BL2_DM_SIGNING_KEY_PATH for signing"
    default n

config TFM_BL2_CM_SIGNING_KEY_PATH
    string
    default "$(TFM_SOURCE_DIR)/bl1/bl1_2/bl1_dummy_rotpk"
    help
      Path to binary BL2 signing private key

config TFM_BL2_SIGNING_ALG
    string
    default "LMS"
    help
      Path to binary BL2 signing private key

config TFM_BL1_MEMORY_MAPPED_FLASH
    bool "BL1 Access flash content"
    default y

config TFM_BL1_DEFAULT_OTP
    bool
    default y
    help
      Whether BL1_1 will use default OTP memory

config TFM_BL1_DEFAULT_PROVISIONING
    bool
    default y
    help
      Whether BL1_1 will use default provisioning

config TFM_BL1_SOFTWARE_CRYPTO
    bool
    default y
    help
      Whether BL1_1 will use software crypto

config TFM_BL1_2_ENABLE_LMS
    bool "Enable LMS PQ crypto for BL2 verification."
    default n
    help
      Enable LMS PQ crypto for BL2 verification.

config TFM_BL1_2_ENABLE_ECDSA
    bool "Enable ECDSA crypto for BL2 verification."
    default n
    help
      Enable ECSDA crypto for BL2 verification.

config TFM_BL1_IMAGE_VERSION_BL2
    string "Image version of BL2 image"
    default "1.9.0+0"

config TFM_BL1_IMAGE_SECURITY_COUNTER_BL2
    int "Security counter value to include with BL2 image"
    default 1

config TFM_BL1_2_IN_OTP
    bool "Whether BL1_2 is stored in OTP"
    default y

config TFM_BL1_2_IN_FLASH
    bool "Whether BL1_2 is stored in FLASH"
    default n

config BL1_2_BUILD_TYPE
    string "BL1_2 build type"
    default "$(CMAKE_BUILD_TYPE)"

config BL1_1_SHARED_SYMBOLS_PATH
    string "Path to list of symbols that BL1_1 that can be referenced from BL1_2"
    default "${TFM_SOURCE_DIR}/bl1/bl1_1/bl1_1_shared_symbols.txt"

endif
```

## config/build_type/Kconfig.debug
```kconfig
#-------------------------------------------------------------------------------
# SPDX-FileCopyrightText: Copyright The TrustedFirmware-M Contributors
#
# SPDX-License-Identifier: BSD-3-Clause
#
#-------------------------------------------------------------------------------

config MBEDCRYPTO_BUILD_TYPE
    default "relwithdebinfo"

config BL1_2_BUILD_TYPE
    default "relwithdebinfo"

config CONFIG_TFM_HALT_ON_CORE_PANIC
    default y

choice SPM_LOG_LEVEL
    default LOG_LEVEL_VERBOSE
endchoice

choice PARTITION_LOG_LEVEL
    default LOG_LEVEL_VERBOSE
endchoice
```

## config/build_type/Kconfig.minsizerel
```kconfig
#-------------------------------------------------------------------------------
# SPDX-FileCopyrightText: Copyright The TrustedFirmware-M Contributors
#
# SPDX-License-Identifier: BSD-3-Clause
#
#-------------------------------------------------------------------------------

if BL2
config MCUBOOT_LOG_LEVEL
    default "OFF"
endif

choice SPM_LOG_LEVEL
    default SPM_LOG_LEVEL_SILENCE
endchoice

choice PARTITION_LOG_LEVEL
    default LOG_LEVEL_NONE
endchoice
```

## config/build_type/Kconfig.release
```kconfig
#-------------------------------------------------------------------------------
# SPDX-FileCopyrightText: Copyright The TrustedFirmware-M Contributors
#
# SPDX-License-Identifier: BSD-3-Clause
#
#-------------------------------------------------------------------------------

config MBEDCRYPTO_BUILD_TYPE
    default "minsizerel"

config BL1_2_BUILD_TYPE
    default "minsizerel"

if BL2
config BL2_LOG_LEVEL
    default LOG_LEVEL_NONE
endif

choice SPM_LOG_LEVEL
    default LOG_LEVEL_NONE
endchoice

choice PARTITION_LOG_LEVEL
    default LOG_LEVEL_NONE
endchoice
```

## platform/Kconfig
```kconfig
#-------------------------------------------------------------------------------
# SPDX-FileCopyrightText: Copyright The TrustedFirmware-M Contributors
#
# SPDX-License-Identifier: BSD-3-Clause
#
#-------------------------------------------------------------------------------

menu "Platform options"

rsource "Kconfig.arch"

config SECURE_UART1
    bool "Enable secure UART1"
    default n

config TFM_DUMMY_PROVISIONING
    bool "Provision with dummy values"
    default y
    depends on !MCUBOOT_GENERATE_SIGNING_KEYPAIR && !TFM_GENERATE_BL1_2_CM_SIGNING_KEY && !TFM_GENERATE_BL1_2_DM_SIGNING_KEY
    select PLATFORM_DEFAULT_OTP_WRITEABLE if PLATFORM_DEFAULT_OTP
    help
      NOT to be used in production

################################# Crypto dependencies ##########################

config CRYPTO_HW_ACCELERATOR
    bool "Enable the crypto hardware accelerator"
    depends on CRYPTO_HW_ACCELERATOR_TYPE != ""
    default n

rsource "Kconfig.fpu"
rsource "Kconfig.platform"

endmenu
```

## platform/ext/target/arm/rse/tc/tc4/Kconfig
```kconfig
#-------------------------------------------------------------------------------
# SPDX-FileCopyrightText: Copyright The TrustedFirmware-M Contributors
#
# SPDX-License-Identifier: BSD-3-Clause
#
#-------------------------------------------------------------------------------

config ARCH_ARM_V81M
    def_bool y
```

## platform/ext/target/stm/common/devicetree/bindings/clock/fixed-clock.yaml
```yaml
# Copyright (c) 2019 Derek Hageman <hageman@inthat.cloud>
# SPDX-License-Identifier: Apache-2.0

description: Generic fixed-rate clock provider

compatible: "fixed-clock"

include: clock-controller.yaml

properties:
  clock-frequency:
    type: int
    description: output clock frequency (Hz)
    required: true

  clocks:
    type: array
    description: input clock source

  "#clock-cells":
    const: 0

  st,bypass:
    type: boolean
    description: activates bypass mode (only for HSE, LSE)

  st,digbypass:
    type: boolean
    description: activates digital bypass mode

  st,css:
    type: boolean
    description: activates the clock security system (only for HSE, LSE)

  st,drive:
    type: int
    description: contains the value of the drive (only for LSE)
    enum: [0, 1, 2, 3]
```

## platform/ext/target/stm/common/devicetree/bindings/i2c/i2c-controller.yaml
```yaml
# Copyright (c) 2017 I-SENSE group of ICCS
# SPDX-License-Identifier: Apache-2.0

# Common fields for I2C controllers

include: base.yaml

bus: i2c

properties:
  "#address-cells":
    required: true
    const: 1
  "#size-cells":
    required: true
    const: 0
  clock-frequency:
    type: int
    description: Initial clock frequency in Hz
  i2c-analog-filter:
    type: boolean
    description: Enable analog filter for i2c lines.
  i2c-scl-rising-time-ns:
    type: int
    description: |
      Number of nanoseconds the SCL signal takes to rise; t(r) in the I2C specification
  i2c-scl-falling-time-ns:
    type: int
    description: |
      Number of nanoseconds the SCL signal takes to fall; t(f) in the I2C specification.
```

## platform/ext/target/stm/common/devicetree/bindings/memory-controllers/st,stm32mp25-omm.yaml
```yaml
# Copyright (c) 2024 STMICROELECTRONICS
# SPDX-License-Identifier: Apache-2.0

description: |
  The STM32 Octo Memory Manager is a low-level interface that enables an
  efficient OCTOSPI pin assignment with a full I/O matrix (before alternate
  function map) and multiplex of single/dual/quad/octal SPI interfaces over
  the same bus.

compatible: "st,stm32mp25-omm"

include:
  - base.yaml
  - pinctrl-device.yaml
  - reset-device.yaml
  - access-device.yaml
  - memory-region.yaml
  - st,stm32mp25-rif.yaml
  - name: st,stm32mp25-syscfg-properties.yaml
    property-allowlist:
      - st,syscfg-amcr

properties:
  reg:
    required: true

  clocks:
    required: true

  st,syscfg-amcr:
    required: true

  st,omm-req2ack-ns:
    type: int
    description: |
      In multiplexed mode (MUXEN = 1), this field defines the time in
      nanoseconds between two transactions.

  st,omm-cssel-ovr:
    type: int
    description: |
      Configure the chip select selector override for the 2 OCTOSPIs.
      The 2 bits mask muxing description is:
        -bit 0: Chip select selector override setting for OCTOSPI1
          0x0: the chip select signal from OCTOSPI1 is sent to NCS1
          0x1: the chip select signal from OCTOSPI1 is sent to NCS2
        -bit 1: Chip select selector override setting for OCTOSPI2
          0x0: the chip select signal from OCTOSPI2 is sent to NCS1
          0x1: the chip select signal from OCTOSPI2 is sent to NCS2

  st,omm-mux:
    type: int
    description: |
      Configure the muxing between the 2 OCTOSPIs busses and the 2 output ports.
      The muxing 2 bits mask description is:
        - 0x0: direct mode, default
        - 0x1: mux OCTOSPI1 and OCTOSPI2 to port 1
        - 0x2: swapped mode
        - 0x3: mux OCTOSPI1 and OCTOSPI2 to port 2
```

## platform/ext/target/stm/common/devicetree/bindings/mmc/mmc-controller.yaml
```yaml
# Copyright (c) 2024 STMICROELECTRONICS
# SPDX-License-Identifier: Apache-2.0

description: |
  These properties are common to multiple MMC host controllers. Any host
  that requires the respective functionality should implement them using
  these definitions.

properties:
  vmmc-supply:
    type: phandle
    description: Reference to the regulator that controls the card power

  vqmmc-supply:
    type: phandle
    description: Reference to the regulator that controls the bus IO line power

  max-frequency:
    type: int
    description: |
      Maximum operating frequency of the bus

  bus-width:
    type: int
    description: |
      Number of data lines
    enum:
      - 1
      - 4
      - 8

  no-mmc:
    type: boolean
    description:
      Controller is limited to send MMC commands during initialization.
```

## platform/ext/target/stm/common/devicetree/bindings/mmc/st,stm32mp25-sdmmc2.yaml
```yaml
# Copyright (c) 2024 STMICROELECTRONICS
# SPDX-License-Identifier: Apache-2.0

description: |
  The ARM PrimeCells SDMMC2 provides an interface for
  reading and writing to MultiMedia and SD cards alike.

compatible: "st,stm32mp25-sdmmc2"

include:
  - base.yaml
  - pinctrl-device.yaml
  - reset-device.yaml
  - mmc-controller.yaml

properties:
  reg:
    required: true

  clocks:
    required: true

  resets:
    required: true

  pinctrl-0:
    required: true

  pinctrl-names:
    required: true

  st,sig-dir:
    type: boolean
    description: |
      ST Micro-specific property, signal direction polarity used for
      pins CMD, DAT[0], DAT[1], DAT[2] and DAT[3].

  st,neg-edge:
    type: boolean
    description: |
      ST Micro-specific property, data and command phase relation,
      generated on the sd clock falling edge.

  st,use-ckin:
    type: boolean
    description: |
      ST Micro-specific property, use CKIN pin from an external
      driver to sample the receive data (for example with a voltage switch
      transceiver).
```
